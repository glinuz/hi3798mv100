## HiSTBLinuxV100R005C00SPC041B020/scripts/kconfig/Kconfig.gpioi2c
```kconfig
#+++++++++++++++++++++++++++++++++++++
#menu "gpio simulate i2c support config"
#+++++++++++++++++++++++++++++++++++++

config HI_GPIOI2C_SUPPORT
	bool "Gpio Simulate I2c Support"
	default y

#+++++++++++++++++++++++++++++++++++++
#endmenu
#+++++++++++++++++++++++++++++++++++++
```

## HiSTBLinuxV100R005C00SPC041B020/scripts/kconfig/Kconfig.gpu
```kconfig
#+++++++++++++++++++++++++++++++++++++++++++++++++++
menu "GPU Config"

config HI_GPU_SUPPORT
	tristate "GPU Support"
	---help---
	  This enables support GPU.

config HI_GPU_MALI400_SUPPORT
	bool
	depends on HI_GPU_SUPPORT && HI3716MV420
	default y

config HI_GPU_MALI450_SUPPORT
	bool
	depends on HI_GPU_SUPPORT && (HI3798MV100 || HI3796MV100 || HI3716DV100 || HI3798MV200 || HI3798MV200_A || HI3796MV200)
	default y

config HI_GPU_MALI700_SUPPORT
	bool
	depends on HI_GPU_SUPPORT && HI3798CV200
	default y

config HI_GPU_DEBUG
	bool "Enable debug in Mali driver"
	depends on HI_GPU_SUPPORT
	---help---
	  This enabled extra debug checks and messages in the Mali driver.

choice
	prompt "EGL Native Window System Config"
	depends on HI_GPU_SUPPORT
	default EGL_FB
config  EGL_FB
	bool "FB"
config  EGL_DFB
	bool "DirectFB"
endchoice

config  HI_EGL_TYPE
	depends on HI_GPU_SUPPORT
	string
	default fb	 if EGL_FB
	default directfb if EGL_DFB

endmenu
#+++++++++++++++++++++++++++++++++++++++++++++++++++
```

## HiSTBLinuxV100R005C00SPC041B020/scripts/kconfig/Kconfig.graph
```kconfig
#+++++++++++++++++++++++++++++++++++++++++++++++++++
menu "Graphic Config"

menuconfig HI_DIRECTFB_SUPPORT
    bool "DirectFB Support"
    default n
    depends on LINUX_PRODUCT

config HI_DIRECTFB_MULTI_SUPPORT
    bool "DirectFB Multi Process support"
    default n
    depends on HI_DIRECTFB_SUPPORT

config HI_DIRECTFB_DEBUG_SUPPORT
    bool "DirectFB Debug support"
    default n
    depends on HI_DIRECTFB_SUPPORT

config HI_DIRECTFB_CA_SUPPORT
    bool "DirectFB Ca Support"
    default n
    depends on HI_DIRECTFB_SUPPORT && HI_ADVCA_SUPPORT

config HI_GFX2D_SUPPORT
    bool "GFX2D Support"
    default y
    depends on ANDROID_PRODUCT
    depends on HI3798CV200 || HI3798MV200 || HI3798MV200_A

config HI_FB0_SMMU_SUPPORT
    bool
    default n
    depends on HI_SMMU_SUPPORT

config HI_FB1_SMMU_SUPPORT
    bool
    default y
    depends on HI_SMMU_SUPPORT

config HI_FB2_SMMU_SUPPORT
    bool
    default y
    depends on HI_SMMU_SUPPORT

config HIFB_STEREO3D_SUPPORT
    bool "3D Support"
    default y

config  HIFB_SCROLLTEXT_SUPPORT
    bool "Scrolltext in FB Support"
    default n

#config  HIFB_CURSOR_SUPPORT
#    bool "Cursor in FB Support"
#    default n

config  HI_FB_DECOMPRESS_SUPPORT
    bool "DeCompress in FB Support"
    default y
    depends on HI_GFX2D_SUPPORT
    depends on HI3798CV200 || HI3798MV200 || HI3798MV200_A

config  HI_GFX_DEBUG_LOG_SUPPORT
    bool "Graphic Debug Log Support"
    default n

config  HI_TDE_CSCTMPBUFFER_SIZE
    hex "TDE Temporary Buffer Size for YUV Semi-planar to YUV Package 422 or ARGB Conversion"
    default 0x0
    help
      Regard to low quality, the size is 0.
      Regard to middle quality, the size is (input width * input height * 2).
      Regard to high quality, the size is(output width * output height * 3).

config  HI_JPEG6B_STREAMBUFFER_SIZE
    hex "JPEG Stream Buffer Size"
    default 0x100000

config  HI_HD0_FB_VRAM_SIZE
    int "KB, HD0 FrameBuffer Size"
    default 7200
    help
      For 1280*720, triple buffer, ARGB8888 format, the size is calculated as below:
      (1280*720*4*2/1024)KB

config  HI_HD1_FB_VRAM_SIZE
    int "KB, HD1 FrameBuffer Size"
    default 0
    help
      For 1280*720, triple buffer, ARGB8888 format, the size is calculated as below:
      (1280*720*4*2/1024)KB

config  HI_HD2_FB_VRAM_SIZE
    int "KB, HD2 FrameBuffer Size"
    default 0
    help
      For 1280*720, triple buffer, ARGB8888 format, the size is calculated as below:
      (1280*720*4*2/1024)KB

config  HI_SD0_FB_VRAM_SIZE
    int "KB, SD0 FrameBuffer Size "
    default 0
    help
      For 720*576, triple buffer, ARGB8888 format, the size is calculated as below:
      (720*576*4*2/1024)KB

endmenu
#+++++++++++++++++++++++++++++++++++++++++++++++++++
```

## HiSTBLinuxV100R005C00SPC041B020/scripts/kconfig/Kconfig.gstreamer
```kconfig
#+++++++++++++++++++++++++++++++++++++++++++++++++++
menuconfig GSTREAMER_SUPPORT
	bool "Gstreamer Support"
#	depends on HAL_SUPPORT && HI_AUDIO_OMX_SUPPORT
	depends on HI_AUDIO_OMX_SUPPORT
	default y
config  GSTREAMER_FULL_SUPPORT
	bool "Gstreamer Full Support"
	depends on GSTREAMER_SUPPORT
	default y
#+++++++++++++++++++++++++++++++++++++++++++++++++++
```

## HiSTBLinuxV100R005C00SPC041B020/scripts/kconfig/Kconfig.hacodec
```kconfig
menuconfig HI_HACODEC_SUPPORT
    bool "HACODEC Support"
    default y

config HI_HACODEC_MP3DECODE_SUPPORT
    bool "HACODEC MP3 Decode Support"
    depends on HI_HACODEC_SUPPORT
    default n

config HI_HACODEC_AACDECODE_SUPPORT
    bool "HACODEC AAC Decode Support"
    depends on HI_HACODEC_SUPPORT
    default n

config HI_HACODEC_AACENCODE_SUPPORT
    bool "HACODEC AAC Encode Support"
    depends on HI_HACODEC_SUPPORT
    default n

config HI_HACODEC_AC3PASSTHROUGH_SUPPORT
    bool "HACODEC AC3 Passthrough Support"
    depends on HI_HACODEC_SUPPORT
    default n

config HI_HACODEC_AMRNBCODEC_SUPPORT
    bool "HACODEC AMRNB Codec Support"
    depends on HI_HACODEC_SUPPORT
    default n

config HI_HACODEC_AMRWBCODEC_SUPPORT
    bool "HACODEC AMRWB Codec Support"
    depends on HI_HACODEC_SUPPORT
    default n

config HI_HACODEC_BLURAYLPCMDECODE_SUPPORT
    bool "HACODEC BLURAYLPCM Decode Support"
    depends on HI_HACODEC_SUPPORT
    default n

config HI_HACODEC_COOKDECODE_SUPPORT
    bool "HACODEC COOK Decode Support"
    depends on HI_HACODEC_SUPPORT
    default n

config HI_HACODEC_DRADECODE_SUPPORT
    bool "HACODEC DRA Decode Support"
    depends on HI_HACODEC_SUPPORT
    default n

config HI_HACODEC_DTSPASSTHROUGH_SUPPORT
    bool "HACODEC DTS Passthrough Support"
    depends on HI_HACODEC_SUPPORT
    default n

config HI_HACODEC_G711CODEC_SUPPORT
    bool "HACODEC G711 Codec Support"
    depends on HI_HACODEC_SUPPORT
    default n

config HI_HACODEC_G722CODEC_SUPPORT
    bool "HACODEC G722 Codec Support"
    depends on HI_HACODEC_SUPPORT
    default n

config HI_HACODEC_PCMDECODE_SUPPORT
    bool "HACODEC PCM Decode Support"
    depends on HI_HACODEC_SUPPORT
    default n

config HI_HACODEC_TRUEHDPASSTHROUGH_SUPPORT
    bool "HACODEC TRUEHD Passthrough Support"
    depends on HI_HACODEC_SUPPORT
    default n

config HI_HACODEC_WMADECODE_SUPPORT
    bool "HACODEC WMA Decode Support"
    depends on HI_HACODEC_SUPPORT
    default n

config HI_HACODEC_DTSM6DECODE_SUPPORT
    bool "HACODEC DTSM6 Decode Support"
    depends on HI_HACODEC_SUPPORT && ANDROID_PRODUCT
    default n
```

## HiSTBLinuxV100R005C00SPC041B020/scripts/kconfig/Kconfig.hdmi
```kconfig
#+++++++++++++++++++++++++++++++++++++++++++++++++++
menu "HDMI Config"

config  HI_HDMI_SUPPORT_1_4
    bool
    depends on HI3798MV100 || HI3796MV100 || HI3716DV100 || HI3716MV410 || HI3716MV420
    default y

config  HI_HDMI_SUPPORT_2_0
    bool
    depends on HI3798CV200 || HI3798MV200 || HI3798MV200_A || HI3796MV200
    default y

config  HI_HDMI_SUPPORT_HDCP
    bool "HDCP Support"
    help
      If you want to enable HDCP, say y.
    default n

config  HI_HDMI_SUPPORT_CEC
    bool "CEC Support"
    help
      If you want to enable CEC, say y.
    default n

config  HI_HDMI_SUPPORT_DEBUG
    bool "DEBUG Support"
    help
        If you want to enable debug, say y.
    default n

config  HI_HDMI_DEBUG_MEM_SIZE
    hex "DEBUG Memory Size (BYTE)"
    help
      If you want to enable debug, say y.
    default 0x80000

endmenu
#+++++++++++++++++++++++++++++++++++++++++++++++++++
```

## HiSTBLinuxV100R005C00SPC041B020/scripts/kconfig/Kconfig.hifat
```kconfig
config HI_FAT_SUPPORT
	bool "HIFAT support"
	default y
	help
	  If you wan't to support himount, say y here.
```

## HiSTBLinuxV100R005C00SPC041B020/scripts/kconfig/Kconfig.hiplayer
```kconfig
#+++++++++++++++++++++++++++++++++++++++++++++++++++
menuconfig HI_PLAYER_SUPPORT
	bool "HiPlayer Support"
	default y
	depends on HI_CAPTION_SO_SUPPORT && LINUX_PRODUCT
	select HI_OPENSSL_SUPPORT

#------------------------------------------------
choice
	prompt "HiPlayer Version"
	depends on HI_PLAYER_SUPPORT
	default HI_PLAYER_FULL_SUPPORT

config  HI_PLAYER_FULL_SUPPORT
	bool "HiPlayer Full Support"

endchoice
```

## HiSTBLinuxV100R005C00SPC041B020/scripts/kconfig/Kconfig.hitranscoder
```kconfig
config HI_TRANSCODER_SUPPORT
	bool "HiTranscoder Support"
	default n
	depends on LINUX_PRODUCT && (HI3716CV200 || HI3716MV400 || HI3718CV100 || HI3719CV100 || HI3718MV100 || HI3719MV100)
```

## HiSTBLinuxV100R005C00SPC041B020/scripts/kconfig/Kconfig.ir
```kconfig
#++++++++++++++++++++++++++++++++++++++++++++++++++
menu "IR Config"
#--------------------------------

choice
	prompt "IR Device Type"
	default HI_IR_TYPE_S2
config  HI_IR_TYPE_S2
	bool "IR S2"
config  HI_IR_TYPE_STD
	bool "IR Standard"
config  HI_IR_TYPE_LIRC
	bool "IR LIRC"
endchoice


config  HI_IR_NEC_SUPPORT
	bool "NEC Support"
	depends on HI_IR_TYPE_S2
	default y

config  HI_IR_RC6_SUPPORT
	bool "RC6 Support"
	depends on HI_IR_TYPE_S2
	default n

config  HI_IR_RC5_SUPPORT
	bool "RC5 Support"
	depends on HI_IR_TYPE_S2
	default n
 
config  HI_IR_SONY_SUPPORT
	bool "SONY Support"
	depends on HI_IR_TYPE_S2
	default n

config  HI_IR_TC9012_SUPPORT
	bool "TC9012 Support"
	depends on HI_IR_TYPE_S2
	default n

config  HI_IR_CREDIT_SUPPORT
	bool "Credit Support"
	depends on HI_IR_TYPE_S2
	default n

endmenu
#+++++++++++++++++++++++++++++++++++++++++++++++++++
```

## HiSTBLinuxV100R005C00SPC041B020/scripts/kconfig/Kconfig.karaoke
```kconfig
#+++++++++++++++++++++++++++++++++++++++++++++++++++

config HI_KARAOKE_SUPPORT
	bool "KARAOKE Support"
	depends on ANDROID_PRODUCT && (HI3798MV100 || HI3796MV100 || HI3716DV100 || HI3798CV200 || HI3798MV200 || HI3798MV200_A)
	default y

#+++++++++++++++++++++++++++++++++++++++++++++++++++
```

## HiSTBLinuxV100R005C00SPC041B020/scripts/kconfig/Kconfig.kernel
```kconfig
#+++++++++++++++++++++++++++++++++++++++++++++++++++
choice
    prompt "Kernel Version"
    default LINUX-3.18.y

config  LINUX-3.18.y
    bool "linux-3.18.y"
    depends on HI3716MV410 || HI3716MV420 || HI3798MV100 || HI3796MV100 || HI3716DV100 || HI3798CV200 || HI3798MV200 || HI3798MV200_A || HI3796MV200
endchoice

config  HI_KERNEL_VERSION
    string
    default linux-3.18.y if LINUX-3.18.y

config  HI_KERNEL_CFG
    prompt "Kernel Config File"
    string
    help
      Input config file for kernel. Such as xxxxx_defconfig.
      Config files are located in kernel source: arch/arm/configs.

#---------------------------------------------
config  HI_FS_BUILDIN
    bool "Build Rootfs in Kernel"
    default n
    help
      Say y to build rootfs in kernel.
#---------------------------------------------
config  HI_MSP_BUILDIN
    bool "Build MSP in Kernel"
    default n
    help
      Say y to build MSP modules in kernel.

#+++++++++++++++++++++++++++++++++++++++++++++++++++
```
