## HiSTBLinuxV100R005C00SPC041B020/scripts/kconfig/Kconfig.cipher
```kconfig
#+++++++++++++++++++++++++++++++++++++
menu "Cipher Config"
#+++++++++++++++++++++++++++++++++++++

#config HI_CIPHER_SUPPORT
#	bool "Cipher Support"
#	default y
	
config HI_CIPHER_MULTICIPHER_SUPPORT
	bool "Multicipher Support"
#	depends on HI_CIPHER_SUPPORT
	default n
	
config HI_CIPHER_HASH_SUPPORT
	bool "Hash Support"
#	depends on HI_CIPHER_SUPPORT
	default n

#+++++++++++++++++++++++++++++++++++++
endmenu
#+++++++++++++++++++++++++++++++++++++
```

## HiSTBLinuxV100R005C00SPC041B020/scripts/kconfig/Kconfig.common
```kconfig
###############################################################################
config HI_LOG_SUPPORT
    bool "Log Support"
    depends on HI_ADVCA_FUNCTION!=FINAL && HI_ADVCA_FUNCTION!=RELEASE && HI_LOADER_LOG_DISABLE=n
    default y
    ---help---
        If you want to close SDK print, say n.

##############################################################################
config HI_LOG_LEVEL
    int "Compile Log Level (0,4)"
    range 0 4
    default 1
    depends on HI_LOG_SUPPORT
    ---help---
        This option control each CBB compile log level, range from 0 to 4.
        0-the fatal level
        1-the error level
        2-the warning level
        3-the info level
        4-the debug level
        Default 1.
        NOTICE: This value only control the compiling log level of every module, the default output level is always 1(error).

##############################################################################
config HI_LOG_NETWORK_SUPPORT
    bool "Network Log Support"
    default n
    depends on HI_LOG_SUPPORT
    ---help---
        This option control the network log output.
        If enable, supported network output. Default disable.

###############################################################################
config HI_LOG_UDISK_SUPPORT
    bool "UDisk Log Support"
    default n
    depends on HI_LOG_SUPPORT
    ---help---
        This option control the u-disk log. Default disable.
        If enble, the log will be written into u-disk.

###############################################################################
config HI_PROC_SUPPORT
    bool "Proc Support"
    depends on HI_ADVCA_FUNCTION!=FINAL && HI_ADVCA_FUNCTION!=RELEASE
    default y
    ---help---
        If you want to get an advance CA release build, say no. Default enable.

config HI_PROC_WRITE_SUPPORT
    bool "Proc Write Support"
    depends on HI_PROC_SUPPORT
    default y

###############################################################################
menu "DEBUG CONFIG"
config  HI_LOADER_LOG_DISABLE
    bool "Loader Log Disable"
    default n
    help
        Disable the log under LOADER circumstance.

endmenu
###############################################################################
```

## HiSTBLinuxV100R005C00SPC041B020/scripts/kconfig/Kconfig.curl
```kconfig
config HI_CURL_SUPPORT
	bool "Curl Support"
	depends on HI_APPLOADER_MODE_IP
	default n
	help
	  If you wan't to support curl, say y here.
```

## HiSTBLinuxV100R005C00SPC041B020/scripts/kconfig/Kconfig.demux
```kconfig
#+++++++++++++++++++++++++++++++++++++++++++++++++++
menu "DEMUX Config"

config HI_DEMUX_POOLBUF_SIZE
	hex "DEMUX Poolbuf Size"
	default 0x200000
	help
	    Configure section, pes and post channel memory.

endmenu
#+++++++++++++++++++++++++++++++++++++++++++++++++++
```

## HiSTBLinuxV100R005C00SPC041B020/scripts/kconfig/Kconfig.drm
```kconfig
menu "DRM Config"

config HI_PLAYREADY_SUPPORT
    bool "PlayReady Support"
    depends on LINUX_PRODUCT && (HI3798CV200 || HI3798MV200)
    default n

choice
    prompt "PlayReady Type"
    default HI_PLAYREADY_3_0
    depends on HI_PLAYREADY_SUPPORT

config  HI_PLAYREADY_2_0
    bool "PlayReady 2.0"
    depends on ANDROID_PRODUCT

config  HI_PLAYREADY_3_0
    bool "PlayReady 3.0"
    depends on (HI3798CV200 || HI3798MV200)

endchoice

config HI_WIDEVINE_SUPPORT
    bool "Widevine Support"
    depends on LINUX_PRODUCT && (HI3798CV200 || HI3798MV200)
    default n

choice
    prompt "Widevine Type"
    default HI_WIDEVINE_L1
    depends on HI_WIDEVINE_SUPPORT

config  HI_WIDEVINE_L1
    bool "Widevine L1"
    depends on (HI3798CV200 || HI3798MV200)

endchoice

config HI_PROTOBUF_SUPPORT
    bool "Protobuf Support"
    depends on HI_WIDEVINE_SUPPORT
    default y

endmenu
```

## HiSTBLinuxV100R005C00SPC041B020/scripts/kconfig/Kconfig.env.media
```kconfig
choice
	prompt "Media Type"
	depends on HI_FORCE_ENV_TO_MEDIA

config FORCE_ENV_IN_NAND
	bool "Nand"
config FORCE_ENV_IN_SPI
	bool "SPI_Flash"
config FORCE_ENV_IN_EMMC
	bool "eMMC"
endchoice
```

## HiSTBLinuxV100R005C00SPC041B020/scripts/kconfig/Kconfig.exfat
```kconfig
#+++++++++++++++++++++++++++++++++++++++++++++++++++
config HI_EXFAT_SUPPORT
	bool "exFAT  Support"
	default n

#+++++++++++++++++++++++++++++++++++++++++++++++++++
```

## HiSTBLinuxV100R005C00SPC041B020/scripts/kconfig/Kconfig.flash
```kconfig
#+++++++++++++++++++++++++++++++++++++++++++++++++++
menu "Flash Config"
#--------------------------------
menuconfig HI_NAND_FLASH_SUPPORT
	bool "Nand Flash support"

choice
	prompt "Nand Flash support"
	depends on HI_NAND_FLASH_SUPPORT

config HI_NAND_SUPPORT
	bool "Nand Flash Support"
	depends on HI_NAND_FLASH_SUPPORT
	help

config HI_SPI_NAND_SUPPORT
	bool "Spi-Nand Flash Support"
	depends on HI_NAND_FLASH_SUPPORT
	help

endchoice

config  HI_NAND_BLOCK_SIZE
	hex "Block Size"
	depends on HI_NAND_SUPPORT || HI_SPI_NAND_SUPPORT
	default 0x20000
	help
	  Nand flash block size if you have nand.

config  HI_NAND_PAGE_SIZE
	string "Page Size"
	depends on HI_NAND_SUPPORT || HI_SPI_NAND_SUPPORT
	default 2k
	help
	  Nand flash page size, such as 2k,4k,8k.

config  HI_NAND_ECC_TYPE
	string "ECC Type"
	depends on HI_NAND_SUPPORT || HI_SPI_NAND_SUPPORT
	default 1bit
	help
	  Nand flash chip ECC type, such as 1bit,4bit,8bit,24bit,40bit.

#--------------------------------
menuconfig HI_SPI_SUPPORT
	bool "SPI Flash Support"
	depends on !(HI3798MV100 || HI3796MV100 || HI3716DV100)
	default y
	help

config  HI_SPI_BLOCK_SIZE
	hex "Block Size"
	depends on HI_SPI_SUPPORT
	default 0x10000
	help
	  SPI flash block size.

#--------------------------------

config HI_EMMC_SUPPORT
	bool "eMMC Flash Support"
	default n
	help
	  Say y here to enables emmc flash support.
#+++++++++++++++++++++++++++++++++++++++++++++++++++
endmenu
```

## HiSTBLinuxV100R005C00SPC041B020/scripts/kconfig/Kconfig.frontend
```kconfig
menuconfig HI_FRONTEND_SUPPORT
    bool "Frontend Support"
    depends on !HI3798MV100
    default y
    help

config  HI_DVBC_SUPPORT
    bool "DVB-C Support"
    depends on HI_FRONTEND_SUPPORT
    default y
    help

source "scripts/kconfig/Kconfig.frontend.dvb_c"

config  HI_DVBS_SUPPORT
    bool "DVB-S/S2 Support"
    depends on HI_FRONTEND_SUPPORT
    default n
    help

source "scripts/kconfig/Kconfig.frontend.dvb_s"

config  HI_DVBT_SUPPORT
    bool "DVB-T/T2/ISDBT/DTMB Support"
    depends on HI_FRONTEND_SUPPORT
    default n
    help

source "scripts/kconfig/Kconfig.frontend.dvb_t"
```

## HiSTBLinuxV100R005C00SPC041B020/scripts/kconfig/Kconfig.frontend.dvb_c
```kconfig
menu "DVB-C Demod Config"
    depends on HI_DVBC_SUPPORT

config  HI_DEMOD_TYPE_X5HDV2QAM
    bool "HI3130_INSIDE Support"
    depends on HI3716MV410 || HI3716MV420
    default y

config  HI_DEMOD_TYPE_HI3130
    bool "HI3130_OUTSIDE Support"
    default y
    select HI_GPIOI2C_SUPPORT

config  HI_DEMOD_TYPE_J83B
    bool "J83B Support"
    default y
    select HI_GPIOI2C_SUPPORT

config  HI_DEMOD_TYPE_MXL254
    bool "MXL254 Support"
    default n
    select HI_GPIOI2C_SUPPORT

config  HI_DEMOD_TYPE_MXL214
    bool "MXL214 Support"
    default n
    select HI_GPIOI2C_SUPPORT

config  HI_DEMOD_TYPE_TDA18280
    bool "TDA18280 Support"
    default n
    select HI_GPIOI2C_SUPPORT

config  HI_DEMOD_TYPE_HI3138
    bool "HI3138 Support"
    default y
    select HI_GPIOI2C_SUPPORT
endmenu

menu "DVB-C Tuner Config"
    depends on HI_DVBC_SUPPORT

config  HI_TUNER_TYPE_TDA18250
    bool "TDA18250 Support"
    default y

config  HI_TUNER_TYPE_TDA18250B
    bool "TDA18250B Support"
    default y

config  HI_TUNER_TYPE_MXL254
    bool "MXL254 Support"
    default n

config  HI_TUNER_TYPE_MXL214
    bool "MXL214 Support"
    default n

config  HI_TUNER_TYPE_TDA18280
    bool "TDA18280 Support"
    default n

config  HI_TUNER_TYPE_MXL203
    bool "MXL203 Support"
    default n

config  HI_TUNER_TYPE_MXL603
    bool "MXL603 Support"
    default n

config  HI_TUNER_TYPE_ALPS_TDAE
    bool "ALPS_TDAE Support"
    default n

config  HI_TUNER_TYPE_TDCC
    bool "TDCC Support"
    default n

config  HI_TUNER_TYPE_MT2081
    bool "MT2081 Support"
    default n

config  HI_TUNER_TYPE_TMX7070X
    bool "TMX7070X Support"
    default n

config  HI_TUNER_TYPE_R820C
    bool "R820C Support"
    default n

config  HI_TUNER_TYPE_TDA6651
    bool "TDA6651 Support"
    default n

config  HI_TUNER_TYPE_XG_3BL
    bool "XG_3BL Support"
    default n

config  HI_TUNER_TYPE_CD1616
    bool "CD1616 Support"
    default n

config  HI_TUNER_TYPE_CD1616_LF_GIH_4
    bool "CD1616_LF_GIH_4 Support"
    default n

config  HI_TUNER_TYPE_si2147
    bool "si2147 Support"
    default y

config  HI_TUNER_TYPE_MXL608
    bool "MXL608 Support"
    default y

config  HI_TUNER_TYPE_M88TC3800
    bool "M88TC3800 Support"
    default y

config  HI_TUNER_TYPE_RAFAEL836
    bool "Rafael836 Support"
    default y

endmenu
```

## HiSTBLinuxV100R005C00SPC041B020/scripts/kconfig/Kconfig.frontend.dvb_s
```kconfig
menu "DVB-S/S2 Demod Config"
    depends on HI_DVBS_SUPPORT

config  HI_DEMOD_TYPE_AVL6211
    bool "AVL6211 Support"
    default y
    select HI_GPIOI2C_SUPPORT

config  HI_DEMOD_TYPE_HI3136
    bool "HI3136 Support"
    default y
    select HI_GPIOI2C_SUPPORT

config  HI_DEMOD_TYPE_HI3138
    bool "HI3138 Support"
    default y
    select HI_GPIOI2C_SUPPORT
config  HI_DEMOD_TYPE_TP5001
    bool "TP5001 Support"
    default n
    select HI_GPIOI2C_SUPPORT

config  HI_DEMOD_TYPE_HD2501
    bool "HD2501 Support"
    default n
    select HI_GPIOI2C_SUPPORT	
endmenu

menu "DVB-S/S2 Tuner Config"
    depends on HI_DVBS_SUPPORT

config  HI_TUNER_TYPE_AV2011
    bool "AV2011 Support"
    default y

config  HI_TUNER_TYPE_AV2018
    bool "AV2018 Support"
    default y

config  HI_TUNER_TYPE_SHARP7903
    bool "SHARP7903 Support"
    default y

config  HI_TUNER_TYPE_RDA5815
    bool "RDA5815 Support"
    default y

config  HI_TUNER_TYPE_M88TS2022
    bool "M88TS2022 Support"
    default y

config  HI_TUNER_TYPE_AV2026
    bool "AV2026 Support"
    default n
endmenu

#--------------------------------
config HI_DISEQC_SUPPORT
    bool "DISEQC Support"
    depends on HI_DVBS_SUPPORT
    default n

menu "LNB Chip Config"
    depends on HI_DVBS_SUPPORT

config  HI_LNB_CTRL_ISL9492
    bool "ISL9492 Support"
    default n

config  HI_LNB_CTRL_MPS8125
    bool "MPS8125 Support"
    default n
endmenu
```

## HiSTBLinuxV100R005C00SPC041B020/scripts/kconfig/Kconfig.frontend.dvb_t
```kconfig
menu "DVB-T/T2/ISDBT/DTMB Demod Config"
    depends on HI_DVBT_SUPPORT

config  HI_DEMOD_TYPE_HI3137
    bool "HI3137 Support"
    default y
    select HI_GPIOI2C_SUPPORT

config  HI_DEMOD_TYPE_CXD2837
    bool "CXD2837 Support"
    default y
    select HI_GPIOI2C_SUPPORT

config  HI_DEMOD_TYPE_MXL101
    bool "MXL101 Support"
    default y
    select HI_GPIOI2C_SUPPORT

config  HI_DEMOD_TYPE_MN88472
    bool "MN88472 Support"
    default y
    select HI_GPIOI2C_SUPPORT

config  HI_DEMOD_TYPE_MN88473
    bool "MN88473 Support"
    default n
    select HI_GPIOI2C_SUPPORT

config  HI_DEMOD_TYPE_IT9170
    bool "IT9170 Support"
    default y
    select HI_GPIOI2C_SUPPORT

config  HI_DEMOD_TYPE_HI3138
    bool "HI3138 Support"
    default y
    select HI_GPIOI2C_SUPPORT

config  HI_DEMOD_TYPE_ATBM888X
    bool "ATBM888X Support"
    default n
    select HI_GPIOI2C_SUPPORT

config  HI_DEMOD_TYPE_MXL683
    bool "MXL683 Support"
    default n
    select HI_GPIOI2C_SUPPORT
	
config  HI_DEMOD_TYPE_AVL6381
    bool "AVL6381 Support"
    default n
    select HI_GPIOI2C_SUPPORT

endmenu

menu "DVB-T/T2/ISDBT/DTMB Tuner Config"
    depends on HI_DVBT_SUPPORT

config  HI_TUNER_TYPE_CXD2861
    bool "CXD2861 Support"
    default y

config  HI_TUNER_TYPE_RAFAEL836
    bool "Rafael836 Support"
    default y

config  HI_TUNER_TYPE_MXL603
    bool "MXL603 Support"
    default y

config  HI_TUNER_TYPE_MXL608
    bool "MXL608 Support"
    default y

config  HI_TUNER_TYPE_SI2147
    bool "Si2147 Support"
    default y

config  HI_TUNER_TYPE_TDA182I5A
    bool "TDA182I5A Support"
    default y

config  HI_TUNER_TYPE_SI2144
    bool "SI2144 Support"
    default y

config  HI_TUNER_TYPE_MXL683
    bool "MXL683 Support"
    default n
endmenu
```

## HiSTBLinuxV100R005C00SPC041B020/scripts/kconfig/Kconfig.fstools
```kconfig
#+++++++++++++++++++++++++++++++++++++++++++++++++++
menu "Board Tools Config"
config  HI_TOOL_DOSFS_SUPPORT
    bool "Dosfs Tools Support"
    default n

config  HI_TOOL_E2FSPROGS_SUPPORT
    bool "Ext2/Ext3 Tools Support"
    default n

config  HI_TOOL_FILECAP_SUPPORT
    bool "Filecap Tools Support"
    default n
    help
        Filecap is used to change permission of files/dirs.
        Only for CA user, if don't use CA, say n here.

config  HI_TOOL_GDB_SUPPORT
    bool "GDB/GDBServer Tools Support"
    depends on HI_ENG_MODE
    default y

config  HI_TOOL_IPTABLES_SUPPORT
    bool "Iptables Tools Support"
    default n

config  HI_TOOL_MTDUTILS_SUPPORT
    bool "Mtdutils Tools Support"
    default n

config  HI_TOOL_REG_SUPPORT
    bool "Read/Write Registers Tools Support"
    default y

config  HI_TOOL_REG_UART_SUPPORT
    bool "Read/Write Registers Tools for UART Support"
    default n
    help
        This tools is used for registers read/write. Not like
        HI_TOOL_REG_SUPPORT, this tool only output some specific
        messages. This is only for PC tool HITOOL.

config  HI_TOOL_SANDBOX_SUPPORT
    bool "Sandbox Tool(Chroot) Support"
    default y
    depends on HI_ADVCA_SANDBOX_TYPE = CHROOT
    help
        This tools is used only for CA, if no CA,say n here.

config  HI_TOOL_PPPD_SUPPORT
    bool "PPPD Tool Support"
    default n

config  HI_TOOL_MIITOOLS_SUPPORT
    bool "Mii Tool Support"
    default n

config  HI_TOOL_IPERF_SUPPORT
    bool "Iperf Support"
    default n

config  HI_LXC_CONTAINER_SUPPORT
    bool "LXC Container Tools Support"
    default y
    depends on HI_ADVCA_SANDBOX_TYPE = LXC

config  HI_TOOL_SYSSTAT_SUPPORT
    bool "Sysstat Tool Support"
    default n

config  HI_TOOL_SOC_SERVER
    bool "SOC Server Tool Support"
    default n

config  HI_TOOL_MSP_DEBUG_SUPPORT
    bool "Msp Debug Tool Support"
    default n

config  HI_TOOL_PQ_DEBUG_SUPPORT
    bool "PQ Debug Tool Support"
    default y
endmenu

menu "Busybox Config"

config  HI_BUSYBOX_CFG_NAME
    string "Busybox Config File For Root"
    default glibc.config
    help
      Input config file for root busybox. Such as xxxxx.config.
      Config files are located in busybox source: busybox-1.*.1.config/

config  HI_BUSYBOX_CFG_SANDBOX_NAME
    string "Busybox Config File For Sandbox User"
    default glibc_ca_sandbox.config
    depends on HI_ADVCA_SANDBOX_SUPPORT
    help
      Input config file for sandbox user busybox. Such as xxxxx.config.
      Config files are located in busybox source: busybox-1.*.1.config/

endmenu

config  HI_LIBCPP_SUPPORT
    bool "C++ Runtime Libarary Support"
    default y
    help
      If you need use C++ libarary, say y here.

#---------------------------------------------
#+++++++++++++++++++++++++++++++++++++++++++++++++++
```
