## HiSTBLinuxV100R005C00SPC041B020/scripts/kconfig/Kconfig.board.videodac
```kconfig
#+++++++++++++++++++++++++++++++++++++++++++++++++++
menu "Video DAC Config"

config HI_DAC_CVBS
    int "CVBS"
    range 0 5
    help
        DAC number used as CVBS.
    default 3

config HI_DAC_YPBPR_Y
    depends on !(HI3798MV100 || HI3796MV100 || HI3716DV100 || HI3798CV200 || HI3798MV200 || HI3798MV200_A)
    int "YPBPR_Y"
    range 0 5
    help
        DAC number used as YPBPR_Y.
    default 1

config HI_DAC_YPBPR_PB
    depends on !(HI3798MV100 || HI3796MV100 || HI3716DV100 || HI3798CV200 || HI3798MV200 || HI3798MV200_A)
    int "YPBPR_PB"
    range 0 5
    help
        DAC number used as YPBPR_PB.
    default 2

config HI_DAC_YPBPR_PR
    depends on !(HI3798MV100 || HI3796MV100 || HI3716DV100 || HI3798CV200 || HI3798MV200 || HI3798MV200_A)
    int "YPBPR_PR"
    range 0 5
    help
        DAC number used as YPBPR_PR.
    default 0

choice
    prompt "Select Chip's Driving Capability"
    default HI_VDP_VDAC_QUARTER_DRIVE

config  HI_VDP_VDAC_FULL_DRIVE
    bool "set the chip to full drive mode "

config  HI_VDP_VDAC_HALF_DRIVE
    bool "set the chip to half drive mode "
    depends on (HI3716MV410 || HI3716MV420)

config  HI_VDP_VDAC_QUARTER_DRIVE
    bool "set the chip to quarter drive mode "
    depends on (HI3716MV410 || HI3716MV420 || HI3798CV200 || HI3798MV200 || HI3798MV200_A)

endchoice
endmenu
#+++++++++++++++++++++++++++++++++++++++++++++++++++
```

## HiSTBLinuxV100R005C00SPC041B020/scripts/kconfig/Kconfig.bootloader
```kconfig
menuconfig HI_LOADER_BOOTLOADER
	bool "BootLoader Config"
	depends on HI_BOOTLOADER_SUPPORT
	default y

#------------------------------------------------
config  HI_BOOTLOADER_MODE_USB
	bool "USB Upgrade Support"
	depends on HI_LOADER_BOOTLOADER
	default y
	select HI_BOOT_USB_SUPPORT

#------------------------------------------------
choice
        prompt "Protocol Type"
        default HI_BOOTLOADER_USB_PROTOCOL_HISI_FILE
        depends on HI_BOOTLOADER_MODE_USB

config  HI_BOOTLOADER_USB_PROTOCOL_HISI_FILE
        bool "Hisi File Protocol"
endchoice

#------------------------------------------------
config  HI_BOOTLOADER_MODE_OTA
	bool "OTA Upgrade Support"
	depends on HI_LOADER_BOOTLOADER
	default n
	select HI_BUILD_WITH_FRONTEND
	select HI_BUILD_WITH_DEMUX

#------------------------------------------------
choice
	prompt "Tuner Type"
	default HI_BOOTLOADER_TUNER_CAB
	depends on HI_BOOTLOADER_MODE_OTA

config  HI_BOOTLOADER_TUNER_CAB
	bool "Cable"

config  HI_BOOTLOADER_TUNER_SAT
	bool "Satellite"

config  HI_BOOTLOADER_TUNER_DVB_T
    bool "Terrestrial DVB_T"

config  HI_BOOTLOADER_TUNER_DVB_T2
    bool "Terrestrial DVB_T2"
endchoice

#------------------------------------------------
config HI_BOOTLOADER_TUNER_INDEX
    int "Tuner Port Index (0,3)"
    range 0 3
    default 0
    depends on HI_BOOTLOADER_MODE_OTA
    ---help---
        This option controls tuner port index, range from 0 to 3.
          0-the cable tuner port index
          1-the cable tuner port index
          2-the cable tuner port index
          3-the cable tuner port index
          Default 0.
        NOTICE: This value control the tuner port index, the default value always 0(cable).
#------------------------------------------------
choice
	prompt "Protocol Type"
	default HI_BOOTLOADER_PROTOCOL_HISI_OTA
	depends on HI_BOOTLOADER_MODE_OTA

config  HI_BOOTLOADER_PROTOCOL_SSU_OTA
	bool "SSU Protocol"

config  HI_BOOTLOADER_PROTOCOL_HISI_OTA
	bool "Hisi OTA Protocol"
endchoice
```

## HiSTBLinuxV100R005C00SPC041B020/scripts/kconfig/Kconfig.caption
```kconfig
#+++++++++++++++++++++++++++++++++++++++++++++++++++
menu "Caption Config"

#------------------------------------------------
config  HI_CAPTION_SUBT_SUPPORT
	bool "Dvb Subtitle Support"
	default n

#------------------------------------------------
config  HI_CAPTION_TTX_SUPPORT
	bool "Teletext Support"
	default n

#------------------------------------------------
config  HI_CAPTION_SO_SUPPORT
	bool "Subtitle Output Support"
	default y

#------------------------------------------------
config  HI_CAPTION_CC_SUPPORT
	bool "Closed Caption Support"
	default n

#------------------------------------------------
endmenu
#+++++++++++++++++++++++++++++++++++++++++++++++++++
```
