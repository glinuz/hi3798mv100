## HiSTBLinuxV100R005C00SPC041B020/scripts/kconfig/Kconfig.board.bootreg
```kconfig
#+++++++++++++++++++++++++++++++++++++++++++++++++++
menu "Boot Regfile Config"
    depends on !HI_UNIFIED_BOOT_SUPPORT || HI_ADVCA_SUPPORT

config  HI_BOOT_REG_NAME
    prompt "Boot Reg File"
    string
endmenu

menu "Boot Regfile Config List"
    depends on HI_UNIFIED_BOOT_SUPPORT && !HI_ADVCA_SUPPORT

config  HI_BOOT_REG_NAME
    prompt "Boot Reg File 0 (3.3V)"
    string

config  HI_BOOT_REG1_NAME
    prompt "Boot Reg File 1 (2.475V)"
    string

config  HI_BOOT_REG2_NAME
    prompt "Boot Reg File 2 (1.925V)"
    string

config  HI_BOOT_REG3_NAME
    prompt "Boot Reg File 3 (1.375V)"
    string

config  HI_BOOT_REG4_NAME
    prompt "Boot Reg File 4 (0.825V)"
    string

config  HI_BOOT_REG5_NAME
    prompt "Boot Reg File 5 (0V)"
    string
endmenu
#+++++++++++++++++++++++++++++++++++++++++++++++++++
```

## HiSTBLinuxV100R005C00SPC041B020/scripts/kconfig/Kconfig.board.demux
```kconfig
#+++++++++++++++++++++++++++++++++++++++++++++++++++
menu "Demux Config"
	  		  
source "scripts/kconfig/Kconfig.board.demux.if"	  
source "scripts/kconfig/Kconfig.board.demux.tsi"
source "scripts/kconfig/Kconfig.board.demux.tso"

endmenu
#+++++++++++++++++++++++++++++++++++++++++++++++++++
```

## HiSTBLinuxV100R005C00SPC041B020/scripts/kconfig/Kconfig.board.demux.if
```kconfig
#+++++++++++++++++++++++++++++++++++++++++++++++++++
menu "IF Config"	  	  
config HI_IF_TYPE
	prompt "Port Type"
	string
	default parallel_nosync_188
	help
	  The port type on board. Optional values:
	  value            		comment
	  parallel_burst        	-- HI_UNF_DMX_PORT_TYPE_PARALLEL_BURST 
	  parallel_valid        	-- HI_UNF_DMX_PORT_TYPE_PARALLEL_VALID
	  parallel_nosync_188   	-- HI_UNF_DMX_PORT_TYPE_PARALLEL_NOSYNC_188
	  parallel_nosync_204   	-- HI_UNF_DMX_PORT_TYPE_PARALLEL_NOSYNC_204
	  parallel_nosync_188_204       -- HI_UNF_DMX_PORT_TYPE_PARALLEL_NOSYNC_188_204
	  serial 			-- HI_UNF_DMX_PORT_TYPE_SERIAL
	  serial2bit        		-- HI_UNF_DMX_PORT_TYPE_SERIAL2BIT
	  serial_nosync      		-- HI_UNF_DMX_PORT_TYPE_SERIAL_NOSYNC
	  serial2bit_nosync     	-- HI_UNF_DMX_PORT_TYPE_SERIAL2BIT_NOSYNC
        	  
config HI_IF_BIT_SELECTOR
	prompt "Bit Selector"
	string
	default 1
	help
	  Port bit selector:
	  value            		comment
	  0 		-- 7 is the serial data line or the MSB of parallel mode               
	  1		-- 0 is the serial data line or the MSB of parallel mode     
endmenu
#+++++++++++++++++++++++++++++++++++++++++++++++++++
```

## HiSTBLinuxV100R005C00SPC041B020/scripts/kconfig/Kconfig.board.demux.tsi
```kconfig
#+++++++++++++++++++++++++++++++++++++++++++++++++++
menu "TSI Config"	  	  
config HI_TSI_NUMBER
	int "TSI Port Number"
	default 4
	range 0 6
	help
	  Configure the number of TSI port,range (0 ~ 6).
source "scripts/kconfig/Kconfig.board.demux.tsi0"
source "scripts/kconfig/Kconfig.board.demux.tsi1"
source "scripts/kconfig/Kconfig.board.demux.tsi2"
source "scripts/kconfig/Kconfig.board.demux.tsi3"
source "scripts/kconfig/Kconfig.board.demux.tsi4"
source "scripts/kconfig/Kconfig.board.demux.tsi5"     
endmenu
#+++++++++++++++++++++++++++++++++++++++++++++++++++
```

## HiSTBLinuxV100R005C00SPC041B020/scripts/kconfig/Kconfig.board.demux.tsi3
```kconfig
#+++++++++++++++++++++++++++++++++++++++++++++++++++
menu "TSI3 Config"	  	  
config HI_TSI3_TYPE
	prompt "Port Type"
	string
	default parallel_nosync_188
	help
	  The port type on board. Optional values:
	  value            		comment
	  parallel_burst        	-- HI_UNF_DMX_PORT_TYPE_PARALLEL_BURST 
	  parallel_valid        	-- HI_UNF_DMX_PORT_TYPE_PARALLEL_VALID
	  parallel_nosync_188   	-- HI_UNF_DMX_PORT_TYPE_PARALLEL_NOSYNC_188
	  parallel_nosync_204   	-- HI_UNF_DMX_PORT_TYPE_PARALLEL_NOSYNC_204
	  parallel_nosync_188_204       -- HI_UNF_DMX_PORT_TYPE_PARALLEL_NOSYNC_188_204
	  serial 			-- HI_UNF_DMX_PORT_TYPE_SERIAL
	  serial2bit        		-- HI_UNF_DMX_PORT_TYPE_SERIAL2BIT
	  serial_nosync      		-- HI_UNF_DMX_PORT_TYPE_SERIAL_NOSYNC
	  serial2bit_nosync     	-- HI_UNF_DMX_PORT_TYPE_SERIAL2BIT_NOSYNC

config HI_TSI3_CLK_PHASE_REVERSE
	prompt "Port Clock Phase Reverse"
	string
	default 0
	help
	  Wehter the clock phase is reverse. Optional values:
	  value            	comment	              
	  0		-- not reverse the clk 
	  1 		-- reverse the clk            
	  
config HI_TSI3_BIT_SELECTOR
	prompt "Bit Selector"
	string
	default 1
	help
	  Port bit selector:
	  value            		comment
	  0 		-- 7 is the serial data line or the MSB of parallel mode               
	  1		-- 0 is the serial data line or the MSB of parallel mode     
endmenu
#+++++++++++++++++++++++++++++++++++++++++++++++++++
```

## HiSTBLinuxV100R005C00SPC041B020/scripts/kconfig/Kconfig.board.demux.tso
```kconfig
#+++++++++++++++++++++++++++++++++++++++++++++++++++
menu "TSO Config"
config HI_TSO_NUMBER
	int "TSO Port Number"
	default 2
	range 0 2
	help
	  Configure the number of TSO port,range (0 ~ 2).	  	  
source "scripts/kconfig/Kconfig.board.demux.tso0" 
source "scripts/kconfig/Kconfig.board.demux.tso1"   
endmenu
#+++++++++++++++++++++++++++++++++++++++++++++++++++
```

## HiSTBLinuxV100R005C00SPC041B020/scripts/kconfig/Kconfig.board.demux.tso0
```kconfig
#+++++++++++++++++++++++++++++++++++++++++++++++++++
menu "TSO0 Config"
#----------------------clk frequency----------------------
choice
	prompt "Clock Frequency"
	help 
	TSO clock frequency
	default 150M

config  HI_TSO0_CLK_100M
	bool "100M"
config  HI_TSO0_CLK_150M
	bool "150M"
config  HI_TSO0_CLK_1200M
	bool "1200M"
config  HI_TSO0_CLK_1500M
	bool "1500M"
endchoice 
#----------------------clk mode----------------------	  	  
choice
	prompt "Clock Mode"
	help 
	The TSO out clock mode
	default normal

config  HI_TSO0_CLK_MODE_NORMAL
	bool "normal"
config  HI_TSO0_CLK_MODE_JITTER
	bool "jitter"
endchoice
#----------------------valid------------------------------
choice
	prompt "Valid Signal Mode"
	help 
	TSO prot valid signal mode
	default active_output

config  HI_TSO0_VALID_ACTIVE_OUTPUT
	bool "active_output"
config  HI_TSO0_VALID_ACTIVE_HIGH
	bool "active_high"
endchoice
#----------------------serial or parallel----------------------
choice
	prompt "Serial or Parallel"
	help 
	TSO prot valid signal mode
	default serial

config  HI_TSO0_SERIAL
	bool "serial"
config  HI_TSO0_PARALLEL
	bool "parallel"
endchoice    
#----------------------bit selector----------------------
choice
	prompt "Bit Selector"
	help 
	TSO bit selector
	default 0

config  HI_TSO0_SERIAL_BIT_0
	bool "0"
config  HI_TSO0_SERIAL_BIT_7
	bool "7"
endchoice 
  
endmenu
#+++++++++++++++++++++++++++++++++++++++++++++++++++
```

## HiSTBLinuxV100R005C00SPC041B020/scripts/kconfig/Kconfig.board.eth
```kconfig
#+++++++++++++++++++++++++++++++++++++++++++++++++++
menu "Ethernet Config"
config  HI_ETH_SUPPORT
        bool "Ethernet Support"
        default y
        help
          Support ethernet function enables you to use ethernet.
          You should say y here, unless you really know what are
          you doing. Say no here can get a smaller fastboot.

endmenu
#+++++++++++++++++++++++++++++++++++++++++++++++++++
```

## HiSTBLinuxV100R005C00SPC041B020/scripts/kconfig/Kconfig.board.keyled
```kconfig
#+++++++++++++++++++++++++++++++++++++++++++++++++++
menu "Keyled Config"
#--------------------------------
choice
        prompt "Keyled Device Used"
        default HI_KEYLED_CT1642_SELECT
config  HI_KEYLED_74HC164_SELECT
        bool "74HC164 Keyled Select"
        depends on HI_KEYLED_74HC164_SUPPORT
config  HI_KEYLED_GPIOKEY_SELECT
        bool "Gpio Key Select"
        depends on HI_KEYLED_GPIOKEY_SUPPORT
config  HI_KEYLED_CT1642_SELECT
        bool "Ct1642 Keyled Select"
        depends on HI_KEYLED_CT1642_SUPPORT
config  HI_KEYLED_PT6961_SELECT
        bool "Pt6961 Keyled Select"
        depends on HI_KEYLED_PT6961_SUPPORT
config  HI_KEYLED_PT6964_SELECT
        bool "Pt6964 Keyled Select"
        depends on HI_KEYLED_PT6964_SUPPORT
config  HI_KEYLED_FD650_SELECT
        bool "Fd650 Keyled Select"
        depends on HI_KEYLED_FD650_SUPPORT
endchoice

config  HI_GPIO_LIGHT_SUPPORT
        bool "Gpio Light Support"
        default n
config  HI_POSITIVE_GPIO_LIGHT_NUMBER
        depends on HI_GPIO_LIGHT_SUPPORT
        hex "Positive Gpio Number"
        default 0x2f
config  HI_NEGATIVE_GPIO_LIGHT_NUMBER
        depends on HI_GPIO_LIGHT_SUPPORT
        hex "Negative Gpio Number"
        default 0x2f
config  HI_POSITIVE_GPIO_LIGHT_NUMBER_QFP
        depends on HI_GPIO_LIGHT_SUPPORT && HI3798MV100
        hex "Positive Gpio Number For QFP"
        default 0x2a
endmenu
```

## HiSTBLinuxV100R005C00SPC041B020/scripts/kconfig/Kconfig.board.mutectrl
```kconfig
#+++++++++++++++++++++++++++++++++++++++++++++++++++
menuconfig HI_SND_MUTECTL_SUPPORT
    bool "Snd Mute Control Support"
    default n

config HI_SND_MUTECTL_GPIO
    hex  "Snd Mute Control Gpio"
    depends on HI_SND_MUTECTL_SUPPORT
    default 0x14
    help
      Mute control gpio
        board_type      level   gpio_pin (gpio_pin = gpio_group * 8 + gpio_num)

config HI_SND_MUTECTL_LEVEL
    int "Snd Mute Control Level (0, 1)"
    depends on HI_SND_MUTECTL_SUPPORT
    range 0 1
    default 0
    help
      mute control gpio
        board_type      level   gpio_pin (gpio_pin = gpio_group * 8 + gpio_num)

#+++++++++++++++++++++++++++++++++++++++++++++++++++
```

## HiSTBLinuxV100R005C00SPC041B020/scripts/kconfig/Kconfig.board.pm
```kconfig
#+++++++++++++++++++++++++++++++++++++
menu "PowerManagement Config"
#+++++++++++++++++++++++++++++++++++++
config HI_PMU_DEVICE_SELECT
        bool "PMU Device Select"
        default n
#+++++++++++++++++++++++++++++++++++++
endmenu
#+++++++++++++++++++++++++++++++++++++
```

## HiSTBLinuxV100R005C00SPC041B020/scripts/kconfig/Kconfig.board.tuner
```kconfig
#+++++++++++++++++++++++++++++++++++++++++++++++++++
menu "Tuner Config"
    depends on !HI3798MV100

config HI_TUNER_NUMBER
	int "Tuner Number"
	default 1
	range 0 4
	help
	  Configure the number of board tuner.

source "scripts/kconfig/Kconfig.board.tuner0"
source "scripts/kconfig/Kconfig.board.tuner1"
source "scripts/kconfig/Kconfig.board.tuner2"
source "scripts/kconfig/Kconfig.board.tuner3"

endmenu
#+++++++++++++++++++++++++++++++++++++++++++++++++++
```
