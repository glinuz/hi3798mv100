## HiSTBLinuxV100R005C00SPC041B020/scripts/kconfig/Kconfig.3g
```kconfig
#+++++++++++++++++++++++++++++++++++++++++++++++++++
#--------------------------------
config HI_3G_SUPPORT
	bool "3G Card Support"
	select HI_TOOL_PPPD_SUPPORT
	default n 
	help
	  If you want to use 3G card, Say Y here.
```

## HiSTBLinuxV100R005C00SPC041B020/scripts/kconfig/Kconfig.advca
```kconfig
#+++++++++++++++++++++++++++++++++++++++++++++++++++
menuconfig HI_ADVCA_SUPPORT
	bool "Advance CA Support"
	default n
#--------------------------------
choice
	prompt "Advance CA Type"
	depends on HI_ADVCA_SUPPORT
	default ADVCA_OTHER
config  ADVCA_CONAX
	bool "Conax"
config  ADVCA_NOVEL
	bool "Novel"
config  ADVCA_NAGRA
	bool "Nagra"
config  ADVCA_SUMA
	bool "Suma"
config  ADVCA_CTI
	bool "Cti"
config  ADVCA_VERIMATRIX
	bool "Verimatrix"
config  ADVCA_IRDETO
	bool "Irdeto"
config  ADVCA_PANACCESS
	bool "Panaccess"
config  ADVCA_DCAS
	bool "Dcas"
config  ADVCA_OTHER
	bool "Other"
endchoice

config  HI_ADVCA_TYPE
	string
	depends on HI_ADVCA_SUPPORT
	default CONAX           if ADVCA_CONAX
	default NOVEL           if ADVCA_NOVEL
	default NAGRA           if ADVCA_NAGRA
	default SUMA            if ADVCA_SUMA
	default CTI             if ADVCA_CTI
	default VERIMATRIX      if ADVCA_VERIMATRIX
	default IRDETO		if ADVCA_IRDETO
	default PANACCESS	if ADVCA_PANACCESS
	default DCAS		if ADVCA_DCAS
	default OTHER           if ADVCA_OTHER
#--------------------------------


menuconfig ADVCA_FUNCTION
	bool "Advance CA Function"
	depends on HI_ADVCA_SUPPORT
	default n

choice
	prompt "Advca Function"
	depends on ADVCA_FUNCTION

config  FUNCTION_DEBUG
	bool "DEBUG"
	select HI_ADVCA_SANDBOX_SUPPORT if !HI_LOADER_APPLOADER
config  FUNCTION_RELEASE
	bool "RELEASE"
	select HI_ADVCA_SANDBOX_SUPPORT if !HI_LOADER_APPLOADER
config  FUNCTION_FINAL
	bool "FINAL"
	select HI_ADVCA_SANDBOX_SUPPORT if !HI_LOADER_APPLOADER

endchoice

config  HI_ADVCA_FUNCTION
	string	
	depends on ADVCA_FUNCTION
	default DEBUG       if FUNCTION_DEBUG
	default RELEASE     if FUNCTION_RELEASE
	default FINAL       if FUNCTION_FINAL

config HI_STATIC_LIB_ONLY
	bool
	default y
	depends on ADVCA_FUNCTION

config HI_ADVCA_VERIFY_ENABLE
    bool "Advca verify enable"
    depends on HI_ADVCA_SUPPORT
    help
      If you want to enable boot to verify other images (kernel,loader,rootfs and so on), say y.

config HI_ADVCA_VMX_3RD_SIGN
    bool "Verimatrix Third-Party Sign Solution"
    depends on (HI_ADVCA_SUPPORT && ADVCA_VERIMATRIX)
	default y
    help
      If you want to enable verimatrix third-party signing solution, say y.

config HI_ADVCA_USE_EXT1_RSA_KEY
    bool "Verify with ext1_rsa_key"
    depends on HI_ADVCA_SUPPORT
    default n
    help
      If the boot verify other images (kernel,loader,rootfs and so on) with the ext1_rsa_key which is stored in the key area of signed boot image, say y.
      If this option is not selected, the boot will verify other images with the ext2_rsa_key in bootcode.
      Please refer to source/boot/product/driver/advca/common/auth/ca_config.c for ext2_rsa_key.

#--------------------------------
menuconfig HI_ADVCA_SANDBOX_SUPPORT
	bool "Support Advance CA Sandbox"
	depends on HI_ADVCA_SUPPORT
	default y
	
choice
	prompt "CA Sandbox Type"
	depends on HI_ADVCA_SANDBOX_SUPPORT
	default SANDBOX_CHROOT
config  SANDBOX_CHROOT
	bool "Chroot"
	select HI_TOOL_SANDBOX_SUPPORT
config  SANDBOX_LXC
	bool "LXC"
	select HI_LXC_CONTAINER_SUPPORT

endchoice

config  HI_ADVCA_SANDBOX_TYPE
	string
	depends on HI_ADVCA_SANDBOX_SUPPORT
	default CHROOT        if SANDBOX_CHROOT
	default LXC           if SANDBOX_LXC

#--------------------------------
```

## HiSTBLinuxV100R005C00SPC041B020/scripts/kconfig/Kconfig.alsa
```kconfig
config HI_ALSA_SUPPORT
	bool "ALSA Support"
	depends on LINUX_PRODUCT && !HI_BLUETOOTH_SUPPORT
	default n
```

## HiSTBLinuxV100R005C00SPC041B020/scripts/kconfig/Kconfig.apploader
```kconfig
menuconfig HI_LOADER_APPLOADER
	bool "AppLoader Config"
	depends on HI_APPLOADER_SUPPORT

#------------------------------------------------
choice
	prompt "OSD Language Type"
	default HI_APPLOADER_OSD_LANG_EN
	depends on HI_LOADER_APPLOADER

config  HI_APPLOADER_OSD_LANG_EN
	bool "English"

config  HI_APPLOADER_OSD_LANG_CN
	bool "Chinese"
endchoice

#------------------------------------------------        
config  HI_APPLOADER_INITRD_BASE_ADDR
    hex "Initrd filesystem base addr in mkbootimg tool"
    default 0x3500000
    depends on HI_LOADER_APPLOADER && ADVCA_CONAX
    help
    Initrd filesystem base addr in mkbootimg tool,if initrd=0x4500000 in bootargs,here need set it as 0x3500000
    As mkbootimg will add 0x1000000 kernel space before fs position.

#------------------------------------------------
config  HI_APPLOADER_MODE_USB
	bool "USB Upgrade Support"
	default y
	depends on HI_LOADER_APPLOADER

#------------------------------------------------
choice
        prompt "Protocol Type"
        default HI_APPLOADER_USB_PROTOCOL_HISI_FILE
        depends on HI_APPLOADER_MODE_USB

config  HI_APPLOADER_USB_PROTOCOL_HISI_FILE
        bool "Hisi File Protocol"
endchoice

#------------------------------------------------
config  HI_APPLOADER_MODE_FS
	bool "FileSystem Upgrade Support"
	default y
	depends on HI_LOADER_APPLOADER

#------------------------------------------------
choice
        prompt "Protocol Type"
        default HI_APPLOADER_FS_PROTOCOL_HISI_FILE
        depends on HI_APPLOADER_MODE_FS

config  HI_APPLOADER_FS_PROTOCOL_HISI_FILE
        bool "Hisi File Protocol"
endchoice

#------------------------------------------------
config  HI_APPLOADER_MODE_IP
	bool "IP Upgrade Support"
	depends on HI_LOADER_APPLOADER && !HI_ADVCA_SUPPORT
	default y
	select HI_CURL_SUPPORT

#------------------------------------------------
choice
        prompt "Protocol Type"
        default HI_APPLOADER_IP_PROTOCOL_HISI_FILE
        depends on HI_APPLOADER_MODE_IP

config  HI_APPLOADER_IP_PROTOCOL_HISI_FILE
        bool "Hisi File Protocol"
endchoice

#------------------------------------------------
config  HI_APPLOADER_MODE_OTA
	bool "OTA Upgrade Support"
	default y
	depends on HI_LOADER_APPLOADER && HI_FRONTEND_SUPPORT

#------------------------------------------------
choice
	prompt "Tuner Type"
	default HI_APPLOADER_TUNER_CAB
	depends on HI_APPLOADER_MODE_OTA

config  HI_APPLOADER_TUNER_CAB
	bool "Cable"

config  HI_APPLOADER_TUNER_SAT
	bool "Satellite"

config  HI_APPLOADER_TUNER_DVB_T
    bool "Terrestrial DVB_T"

config  HI_APPLOADER_TUNER_DVB_T2
  	bool "Terrestrial DVB_T2"
endchoice

#------------------------------------------------
config HI_APPLOADER_TUNER_INDEX
    int "Tuner Port Index (0,3)"
    range 0 3
    default 0
    depends on HI_APPLOADER_MODE_OTA
    ---help---
        This option controls tuner port index, range from 0 to 3.
          0-the cable tuner port index
          1-the cable tuner port index
          2-the cable tuner port index
          3-the cable tuner port index
          Default 0.
        NOTICE: This value control the tuner port index, the default value always 0(cable).
#------------------------------------------------
choice
	prompt "Protocol Type"
	default HI_APPLOADER_PROTOCOL_HISI_OTA
	depends on HI_APPLOADER_MODE_OTA

config  HI_APPLOADER_PROTOCOL_SSU_OTA
	bool "SSU Protocol"

config  HI_APPLOADER_PROTOCOL_HISI_OTA
	bool "Hisi OTA Protocol"
endchoice

#+++++++++++++++++++++++++++++++++++++++++++++++++++
```

## HiSTBLinuxV100R005C00SPC041B020/scripts/kconfig/Kconfig.audio
```kconfig
#++++++++++++++++++++++++++++++++++++++++++++++++++++
menu "Audio Config"
#--------------------------------
config  HI_SND_ALSA_AO_SUPPORT
    bool "AO ALSA Support"
    default n

config HI_AI_SUPPORT
    bool "AI Support"
    default n

config  HI_SND_ALSA_AI_SUPPORT
    depends on HI_AI_SUPPORT
    bool "AI ALSA Support"
    default n

config  HI_SND_ALSA_I2S_ONLY_SUPPORT
    depends on HI_SND_ALSA_AI_SUPPORT
    bool "ALSA I2S only Card Support"
    default n

config  HI_SND_ALSA_HDMI_ONLY_SUPPORT
    depends on HI_SND_ALSA_AI_SUPPORT
    bool "ALSA HDMI only Card Support"
    default n

config HI_ADEC_MAX_INSTANCE
    int "ADEC Max Instance Number(1~8)"
    range 1 8
    default 8

config HI_ADEC_AUDSPECTRUM_SUPPORT
    bool "ADEC Audio Spectrum Support"
    default n

config HI_SND_SMARTVOLUME_SUPPORT
    bool "SND Smart Volume Support"
    default n

config HI_SND_HBRA_PASSTHROUGH_SUPPORT
    bool "SND HBRA passthrough support"
    default n if HI3716MV410 || HI3716MV420
    default y
    help
        Say Y here if you want to support HBRA(TRUEHD DTSHD 7.1LPCM) passthrough.
        There will not be enough memmory in SND for HBRA if chosen N.

config HI_AENC_SUPPORT
    bool "AENC Support"
    default y

menuconfig  HI_ADAC_SUPPORT
    bool "ADAC Support"
    default n

choice
    prompt "Codec Support"
    depends on HI_ADAC_SUPPORT

config  HI_ADAC_SLIC_SUPPORT
    bool "slic"

config  HI_ADAC_TVL320AIC31_SUPPORT
    bool "tlv320"

endchoice

config HI_ALSA_TVL320_KERNEL_SUPPORT
    bool "KERNEL Tlv320 Support"
    default n

config HI_AUDIO_OMX_SUPPORT
    bool "OMX Audio Support"
    default n

config HI_SND_SPDIF_DELAY_SUPPORT
    bool "SND SPDIF Compensation"
    default n
#--------------------------------
endmenu
#++++++++++++++++++++++++++++++++++++++++++++++++++++
```

## HiSTBLinuxV100R005C00SPC041B020/scripts/kconfig/Kconfig.avplay
```kconfig
#++++++++++++++++++++++++++++++++++++++++++++++++++++
menu "Avplay Config"
        depends on (HI3716MV410 || HI3716MV420)

#--------------------------------
config HI_AVPLAY_PLAY_AND_REC_SUPPORT
        bool "Avplay Play And Rec On A Demux Support"
        default n

endmenu
#++++++++++++++++++++++++++++++++++++++++++++++++++++
```

## HiSTBLinuxV100R005C00SPC041B020/scripts/kconfig/Kconfig.base
```kconfig
###########################################################
choice
    prompt "Product Type"
    default LINUX_PRODUCT

config  LINUX_PRODUCT
    bool "linux"
config  ANDROID_PRODUCT
    bool "android"
endchoice

config  PRODUCT_TYPE
    string
    default linux            if LINUX_PRODUCT
    default android          if ANDROID_PRODUCT

choice
    prompt "Android Type"
    default ANDROID_AOSP
    depends on ANDROID_PRODUCT

config  ANDROID_AOSP
    bool "AOSP"
config  ANDROID_TVOS
    bool "TVOS"
endchoice

choice
    prompt "Mode"
    default HI_USER_MODE

config  HI_USER_MODE
    bool "user"

config  HI_ENG_MODE
    bool "engineer"
endchoice

###########################################################
choice
    prompt "Chip Type"
    default HI3798CV200

config  HI3716MV410
    bool "hi3716mv410"
config  HI3716MV420
    bool "hi3716mv420"
config  HI3798MV100
    bool "hi3798mv100"
config  HI3798MV200
    bool "hi3798mv200"
config  HI3798MV200_A
    bool "hi3798mv200_a"
config  HI3796MV100
    bool "hi3796mv100"
config  HI3796MV200
    bool "hi3796mv200"
config  HI3716DV100
    bool "hi3716dv100"
config  HI3798CV200
    bool "hi3798cv200"
endchoice

config  HI_CHIP_TYPE
    string
    default hi3716mv410     if HI3716MV410
    default hi3716mv420     if HI3716MV420
    default hi3798mv100     if HI3798MV100
    default hi3798mv200     if HI3798MV200
    default hi3798mv200_a   if HI3798MV200_A
    default hi3796mv100     if HI3796MV100
    default hi3796mv200     if HI3796MV200
    default hi3716dv100     if HI3716DV100
    default hi3798cv200     if HI3798CV200

config  HI_NVR_SUPPORT
    bool
    depends on LINUX_PRODUCT && (HI3798CV200 || HI3796MV200)
    default n
    help
        The development of NVR(Network Video Recorder) related products need to be opened.

config  HI_DONGLE_SUPPORT
    bool "Dongle Board Support"
    depends on HI3798CV200
    default n
    help
        This option should be choose when dongle board is supported.

###########################################################
menu "System Config"

choice
    prompt "System Type"
    default HI_32BIT_SYSTEM

config  HI_32BIT_SYSTEM
    bool "32bit system"

config  HI_64BIT_SYSTEM
    bool "64bit system"
    depends on HI3798CV200 || HI3798MV200 || HI3798MV200_A || HI3796MV200
endchoice

choice
    prompt "User Space Type"
    default HI_USER_SPACE_LIB if HI_32BIT_SYSTEM
    default HI_USER_SPACE_ALL_LIB if HI_64BIT_SYSTEM
    depends on LINUX_PRODUCT

config  HI_USER_SPACE_LIB
    bool "32bit"

config  HI_USER_SPACE_LIB64
    bool "64bit"
    depends on HI_64BIT_SYSTEM

config  HI_USER_SPACE_ALL_LIB
    bool "32bit + 64bit"
    depends on HI_64BIT_SYSTEM
endchoice

config  HI_CPU_ARCH
    string
    default arm     if HI_32BIT_SYSTEM
    default arm64   if HI_64BIT_SYSTEM

endmenu

menu "Toolchains Config"

choice
    prompt "32bit Toolchains"
    default ARM_HISTBV310_LINUX

config  ARM_HISTBV310_LINUX
    bool "arm-histbv310-linux"
endchoice

config  HI_ARM_TOOLCHAINS_NAME
    string
    default arm-histbv310-linux     if ARM_HISTBV310_LINUX

choice
    prompt "64bit Toolchains"
    default AARCH64_HISTBV100_LINUX
    depends on HI_64BIT_SYSTEM

config   AARCH64_HISTBV100_LINUX
    bool "aarch64-histbv100-linux"
endchoice

config  HI_AARCH64_TOOLCHAINS_NAME
    string
    default aarch64-histbv100-linux if AARCH64_HISTBV100_LINUX

endmenu

config  HI_OUT_DIR
    string "Out DIR"
    depends on LINUX_PRODUCT

config  HI_SMMU_SUPPORT
    bool
    depends on HI3798CV200 || HI3798MV200 || HI3798MV200_A || HI3796MV200
    default y

config  HI_HDR_SUPPORT
    bool
    depends on HI3798CV200 || HI3798MV200 || HI3798MV200_A || HI3796MV200
    default y

menuconfig  HI_RECOVERY_SUPPORT
    bool "Recovery Support"
    depends on ANDROID_PRODUCT
    default n

###########################################################
menuconfig  HI_LOADER_SUPPORT
    bool "Loader Support"
    depends on !HI_RECOVERY_SUPPORT
    default n

choice
    prompt "Loader Type"
    depends on HI_LOADER_SUPPORT
    default HI_APPLOADER_SUPPORT

#config  HI_BOOTLOADER_SUPPORT
#    bool "BootLoader"
#    depends on LINUX_PRODUCT

config  HI_APPLOADER_SUPPORT
    bool "AppLoader"
endchoice
###########################################################

config HI_OPTM_SIZE_SUPPORT
    bool "Optimize For Size"
    default n
```

## HiSTBLinuxV100R005C00SPC041B020/scripts/kconfig/Kconfig.bluetooth
```kconfig
#+++++++++++++++++++++++++++++++++++++++++++++++++++
#--------------------------------
menuconfig HI_BLUETOOTH_SUPPORT
	bool "Bluetooth Support"
	depends on LINUX_PRODUCT
	default n
	help
	  ALSA will support too when support Bluetooth.

menu    "BlueTooth Device Type"
	depends on HI_BLUETOOTH_SUPPORT

config  HI_BLUETOOTH_DEVICE_RTL8723BU
	bool "Realtek rtl8723bu bluetooth driver"
config  HI_BLUETOOTH_DEVICE_RTL8761AU
	bool "Realtek rtl8761au bluetooth driver"
config  HI_BLUETOOTH_DEVICE_RTL8821AU
	bool "Realtek rtl8821au bluetooth driver"
config  HI_BLUETOOTH_DEVICE_RTL8822BU
	bool "Realtek rtl8822bu bluetooth driver"
config  HI_BLUETOOTH_DEVICE_MT76X2
	bool "Mtk mt76x2 bluetooth driver"
endmenu
```

## HiSTBLinuxV100R005C00SPC041B020/scripts/kconfig/Kconfig.board
```kconfig
#+++++++++++++++++++++++++++++++++++++++++++++++++++
source "scripts/kconfig/Kconfig.board.eth"
source "scripts/kconfig/Kconfig.flash"
source "scripts/kconfig/Kconfig.board.tuner"
source "scripts/kconfig/Kconfig.board.demux"
source "scripts/kconfig/Kconfig.board.keyled"
source "scripts/kconfig/Kconfig.board.pm"
source "scripts/kconfig/Kconfig.board.sci"
source "scripts/kconfig/Kconfig.board.mutectrl"
source "scripts/kconfig/Kconfig.board.videodac"
source "scripts/kconfig/Kconfig.board.bootreg"
#+++++++++++++++++++++++++++++++++++++++++++++++++++
```
