## HiSTBLinuxV100R005C00SPC041B020/scripts/kconfig/Kconfig.keyled
```kconfig
#+++++++++++++++++++++++++++++++++++++++++++++++++++
menu "Keyled Config"
#--------------------------------

#choice
#	prompt "Keyled Type"
#	default KEYLED_PT6964
config  HI_KEYLED_SUPPORT
        bool "Keyled Support"
	default y
config  HI_KEYLED_74HC164_SUPPORT
	bool "74HC164 Keyled"
	depends on HI_KEYLED_SUPPORT
	default n
	
#menu "GpioKey Keyled"
#     depends on HI_KEYLED_SUPPORT 
menuconfig  HI_KEYLED_GPIOKEY_SUPPORT
	bool "GpioKey Keyled Support"
	depends on HI_KEYLED_SUPPORT
	default n
	config  HI_KEYLED_GPIOKEY_POWER_GPIO
                depends on  HI_KEYLED_GPIOKEY_SUPPORT
                hex "Power Gpio Number"
                default 0x2d
        config  HI_KEYLED_GPIOKEY_OK_GPIO
                depends on  HI_KEYLED_GPIOKEY_SUPPORT
                hex "OK Gpio Number"
                default 0xd
        config  HI_KEYLED_GPIOKEY_MENU_GPIO
                depends on  HI_KEYLED_GPIOKEY_SUPPORT
                hex "Menu Gpio Number"
                default 0xe
        config  HI_KEYLED_GPIOKEY_LEFT_GPIO
                depends on  HI_KEYLED_GPIOKEY_SUPPORT
                hex "Left Gpio Number"
                default 0xf
        config  HI_KEYLED_GPIOKEY_RIGHT_GPIO
                depends on  HI_KEYLED_GPIOKEY_SUPPORT
                hex "Right Gpio Number"
                default 0x10
        config  HI_KEYLED_GPIOKEY_UP_GPIO
                depends on  HI_KEYLED_GPIOKEY_SUPPORT
                hex "Up Gpio Number"
                default 0x12
        config  HI_KEYLED_GPIOKEY_DOWN_GPIO
                depends on  HI_KEYLED_GPIOKEY_SUPPORT
                hex "Down Gpio Number"
                default 0x11
#endmenu	

menuconfig HI_KEYLED_CT1642_SUPPORT
	bool "Ct1642 Keyled Support"
	depends on HI_KEYLED_SUPPORT
	default y
	config  HI_KEYLED_CT1642_GPIO_MODE
		bool "Use Ct1642 in GPIO Mode"
		depends on  HI_KEYLED_CT1642_SUPPORT
		help
			Default, Ct1642 will be controlled by chipset, if you want to control it by GPIO, say y, default n.
		default n
	config  HI_KEYLED_CT1642_KERNEL_SUPPORT
		bool "Ct1642 Kernel Support"
		depends on HI_KEYLED_CT1642_GPIO_MODE && HI_MSP_BUILDIN
		default n
	config  HI_KEYLED_CT1642_CLOCK_GPIO
		depends on HI_KEYLED_CT1642_GPIO_MODE
		hex "Clock Gpio Number"
		default 0x29
	config  HI_KEYLED_CT1642_DAT_GPIO
		depends on HI_KEYLED_CT1642_GPIO_MODE
		hex "DAT Gpio Number"
		default 0x28
	config  HI_KEYLED_CT1642_KEY_GPIO
		depends on HI_KEYLED_CT1642_GPIO_MODE
		hex "Key Gpio Number"
		default 0x2f
#endmenu

#menu "Pt6961 Keyled"
#     depends on HI_KEYLED_SUPPORT    
menuconfig  HI_KEYLED_PT6961_SUPPORT
	bool "Pt6961 Keyled Support"
	depends on HI_KEYLED_SUPPORT 
	default n
        config  HI_KEYLED_PT6961_CLOCK_GPIO
                depends on  HI_KEYLED_PT6961_SUPPORT
                hex "Clock Gpio Number"
                default 0x2a
        config  HI_KEYLED_PT6961_STB_GPIO
                depends on  HI_KEYLED_PT6961_SUPPORT
                hex "STB Gpio Number"
                default 0x2b
        config  HI_KEYLED_PT6961_DIN_GPIO
                depends on  HI_KEYLED_PT6961_SUPPORT
                hex "DIN Gpio Number"
                default 0x2c
        config  HI_KEYLED_PT6961_DOUT_GPIO
                depends on  HI_KEYLED_PT6961_SUPPORT
                hex "DOUT Gpio Number"
                default 0x2d
#endmenu

#menu "Pt6964 Keyled"
#     depends on HI_KEYLED_SUPPORT
menuconfig  HI_KEYLED_PT6964_SUPPORT
	bool "Pt6964 Keyled Support"
	depends on HI_KEYLED_SUPPORT
	default n
        config  HI_KEYLED_PT6964_CLOCK_GPIO
                depends on  HI_KEYLED_PT6964_SUPPORT
                hex "Clock Gpio Number"
                default 0x2a
        config  HI_KEYLED_PT6964_STB_GPIO
                depends on  HI_KEYLED_PT6964_SUPPORT
                hex "STB Gpio Number"
                default 0x2b
        config  HI_KEYLED_PT6964_DINOUT_GPIO
                depends on  HI_KEYLED_PT6964_SUPPORT
                hex "DINOUT Gpio Number"
                default 0x2c   
#endmenu

menuconfig  HI_KEYLED_FD650_SUPPORT
	bool "Fd650 Keyled Support"
	depends on HI_KEYLED_SUPPORT
	default n
	config  HI_KEYLED_FD650_CLOCK_GPIO
                depends on  HI_KEYLED_FD650_SUPPORT
                hex "Clock Gpio Number"
                default 0x2b
	 config  HI_KEYLED_FD650_DINOUT_GPIO
                depends on  HI_KEYLED_FD650_SUPPORT
                hex "DINOUT Gpio Number"
                default 0x2d
endmenu
#+++++++++++++++++++++++++++++++++++++++++++++++++++
```

## HiSTBLinuxV100R005C00SPC041B020/scripts/kconfig/Kconfig.mce
```kconfig
config  HI_MCE_SUPPORT
        bool "MCE Support"
        depends on HI_MSP_BUILDIN
        default n
```

## HiSTBLinuxV100R005C00SPC041B020/scripts/kconfig/Kconfig.ntfs
```kconfig
#+++++++++++++++++++++++++++++++++++++++++++++++++++
menuconfig HI_NTFS_SUPPORT
	bool "NTFS Support"
	default n
config  HI_NTFS_MODULE_SUPPORT
	bool "NTFS Module Support"
	depends on HI_NTFS_SUPPORT
	default y
config  HI_NTFS_TOOLS_SUPPORT
	bool "NTFS Tools Support"
	depends on HI_NTFS_SUPPORT
	default y
#+++++++++++++++++++++++++++++++++++++++++++++++++++
```

## HiSTBLinuxV100R005C00SPC041B020/scripts/kconfig/Kconfig.openssl
```kconfig
config HI_OPENSSL_SUPPORT
    bool "Openssl Support"
    depends on LINUX_PRODUCT
    default n
```

## HiSTBLinuxV100R005C00SPC041B020/scripts/kconfig/Kconfig.opera
```kconfig
config HI_OPERA_SUPPORT
	bool "Opera Support"
	default n
	help
      If you want to compile Opera SDK, Select this option first.
      It contains the adapter layer of Opera SDK.
```

## HiSTBLinuxV100R005C00SPC041B020/scripts/kconfig/Kconfig.pvr
```kconfig
#++++++++++++++++++++++++++++++++++++++++++++++++++++
menu "Pvr Config"
#--------------------------------
config HI_PVR_SUPPORT
	bool "PVR Support"
	default y

config HI_PVR_EXTRA_BUF_SUPPORT
	depends on HI_PVR_SUPPORT
	bool "use Extra PVR Buffer to optimize the recording"
	default n
#--------------------------------
endmenu
#++++++++++++++++++++++++++++++++++++++++++++++++++++
```

## HiSTBLinuxV100R005C00SPC041B020/scripts/kconfig/Kconfig.pwm
```kconfig
config HI_PWM_SUPPORT
    bool "PWM Support"
    default y
    depends on HI3716CV200 || HI3718CV100 || HI3719CV100
```

## HiSTBLinuxV100R005C00SPC041B020/scripts/kconfig/Kconfig.resampler
```kconfig
config HI_AUDIO_RESAMPLER_SUPPORT
    bool "Audio resampler Support"
    default y
```

## HiSTBLinuxV100R005C00SPC041B020/scripts/kconfig/Kconfig.rootfs
```kconfig
#---------------------------------------------

menu "File System Config"
config  HI_ROOTFS_STRIP
	bool "Enable Strip"
	default y
	help
	  Whether strip the root filesystem.
	  If you select strip option, you will get fail when use gdb, because the clib is striped.
	       y - strip /bin /lib /sbin /usr
	       n - not strip

config  HI_ROOTFS_INSTALL_SHARED_LIBS
	bool "Install Share Libs to Rootfs"
	default y

config  HI_ROOTFS_CRAMFS
	bool "Create Cramfs Rootfs Image"
	default y

config  HI_ROOTFS_JFFS2
	bool "Create Jffs2 Rootfs Image"
	depends on HI_SPI_SUPPORT
	default y

config  HI_ROOTFS_YAFFS
	bool "Create Yaffs Rootfs Image"
	depends on HI_NAND_SUPPORT || HI_SPI_NAND_SUPPORT
	default y

config  HI_ROOTFS_SQUASHFS
	bool "Create Squashfs Rootfs Image"
	default y

config  HI_ROOTFS_EXT4
	bool "Create ext4 Rootfs Image"
	depends on HI_EMMC_SUPPORT
	default n

config  HI_EMMC_ROOTFS_SIZE
	int "eMMC Rootfs Size"
	depends on HI_ROOTFS_EXT4
	default "96"
	help
	  eMMC rootfs size, unit is M.

config HI_ROOTFS_UBIIMG
	bool "Create Ubi Rootfs Image"
	depends on HI_NAND_SUPPORT
	default y

config HI_UBI_PARTITION_SIZE
	string "UBI Rootfs Size"
	depends on HI_ROOTFS_UBIIMG
	default "96M"

endmenu
#+++++++++++++++++++++++++++++++++++++++++++++++++++
```

## HiSTBLinuxV100R005C00SPC041B020/scripts/kconfig/Kconfig.tee
```kconfig
config HI_TEE_SUPPORT
    bool "TEE Support"
    depends on (HI3798MV100 || HI3796MV100 || HI3716DV100 || HI3798CV200 || HI3798MV200 || HI3798MV200_A)
    default n
    help
        Support trust execution environment enables you to use secure os and memory.
        You should say n here, unless you really know what are you doing.
        Say yes here can get tee.

choice
    prompt "TEE Memory Layout"
    depends on HI_TEE_SUPPORT
    default 1G

config  TVP_MEM_512M
    bool "512M"
config  TVP_MEM_1G
    bool "1G"
config  TVP_MEM_1_5G
    bool "1.5G"
    depends on !(HI3798MV100 || HI3796MV100 || HI3716DV100)
config  TVP_MEM_2G
    bool "2G"
endchoice

config  HI_TVP_MEM_LAYOUT
    string
    depends on HI_TEE_SUPPORT
    default 512M   if TVP_MEM_512M
    default 1G     if TVP_MEM_1G
    default 1_5G     if TVP_MEM_1_5G
    default 2G     if TVP_MEM_2G

menu    "TEE Module List"
	depends on HI_TEE_SUPPORT
	
menuconfig  HI_TEE_VFMW_SUPPORT
    bool "VFMW Support"
    depends on HI_TEE_SUPPORT
    default y
             
menuconfig  HI_TEE_ADVCA_SUPPORT
    bool "ADVCA Support"
    depends on HI_TEE_SUPPORT
    default y
         
menuconfig  HI_TEE_PVR_SUPPORT
    bool "PVR Support"
    depends on HI_TEE_SUPPORT && !(HI3798MV100 || HI3796MV100 || HI3716DV100)
    default y
    
menuconfig  HI_TEE_DEMUX_SUPPORT
    bool "Demux Support"
    depends on HI_TEE_SUPPORT
    default y    

menuconfig  HI_TEE_HDMI_SUPPORT
    bool "HDMI Support"
    depends on HI_TEE_SUPPORT && !(HI3798MV100 || HI3796MV100 || HI3716DV100)
    default y
    
menuconfig  HI_TEE_DEMO_SUPPORT
    bool "DEMO Support"
    depends on HI_TEE_SUPPORT
    default y
    
menuconfig  HI_TEE_VDP_SUPPORT
    bool "VDP Support"
    depends on HI_TEE_SUPPORT && !(HI3798MV100 || HI3796MV100 || HI3716DV100)
    default y 
	
menuconfig  HI_TEE_BEIDOU_SUPPORT
    bool "Beidou Support"
    depends on HI_TEE_SUPPORT && HI3716DV100
    default y 	  

menuconfig  HI_TEE_I2C_SUPPORT
    bool "I2C driver Support"
    depends on HI_TEE_SUPPORT && HI3716DV100
    default y 	

menuconfig  HI_TEE_WIDEVINE_SUPPORT
    bool "Widevine Support"
    depends on HI_TEE_SUPPORT && !(HI3798MV100 || HI3796MV100 || HI3716DV100)
    default y

menuconfig  HI_TEE_PLAYREADY_SUPPORT
    bool "PlayReady Support"
    depends on HI_TEE_SUPPORT && !(HI3798MV100 || HI3796MV100 || HI3716DV100)
    default y 

menuconfig  HI_TEE_VMX_ULTRA_SUPPORT
    bool "Verimatrix Ultra Support"
    depends on VERIMATRIX && HI_TEE_SUPPORT && !(HI3798MV100 || HI3796MV100 || HI3716DV100)
    default y 

config  HI_TEE_VMXTAC_TEST_SUPPORT
	bool "VMXTAC TEST Support"
	depends on VMX_ULTRA_SUPPORT
	default y
	
config  HI_TEE_ITAC_TEST_SUPPORT
	bool "ITAC TEST Support"
	depends on VMX_ULTRA_SUPPORT
    default y
    
endmenu    
```

## HiSTBLinuxV100R005C00SPC041B020/scripts/kconfig/Kconfig.vdec
```kconfig
#+++++++++++++++++++++++++++++++++++++++++++++++++++
menu "Video Decoder Config"
#+++++++++++++++++++++++++++++++++++++++++++++++++++

source "scripts/kconfig/Kconfig.vdec.mem256"
source "scripts/kconfig/Kconfig.vdec.mem512"
source "scripts/kconfig/Kconfig.vdec.mem768"
source "scripts/kconfig/Kconfig.vdec.mem1024"
source "scripts/kconfig/Kconfig.vdec.mem2048"

#####################################################
choice
    prompt "Capability for reserve memory"
    default HI_VIDEO_PRE_CAP_1080P
	depends on HI3716MV410 || HI3716MV420 
	config  HI_VIDEO_PRE_CAP_1080P
    	bool "1080P"
	config  HI_VIDEO_PRE_CAP_MVC
    	bool "MVC"
endchoice

config HI_VIDEO_MAX_REF_FRAME_NUM
    int "Max reference frame number(3-16)"
    range 3 16
    default 6
	depends on HI3716MV410 || HI3716MV420

config HI_VIDEO_MAX_DISP_FRAME_NUM
    int "Extra frame number for schedule(2-16)"
    range 2 16
    default 2
	depends on HI3716MV410 || HI3716MV420

config HI_VIDEO_MAX_VDH_BUF
    int "Max VDH buffer for one decoder(20M-300M)"
    range 20 300
    default 110
	depends on HI3716MV410 || HI3716MV420
######################################################

config  HI_VDEC_DEINTERLACE_SUPPORT
	bool "HD Deinterlace Support"
	default y
	help
		Open deinterlace function, if you have enough memory, say y.

config  HI_VDEC_SVDEC_SUPPORT
	bool "Soft Video Decode(hi_svdec.ko) Support"
	default y
	help
		For Hi3712, if you want to support H263, say y;
		For Hi3716C/Hi3716H/Hi3716M, if you want to support H263 or VP6, say y;

config  HI_VDEC_REG_CODEC_SUPPORT
	bool "External Video Codec Register Support"
	default n
	help
		If you want to use API "HI_UNF_AVPLAY_RegisterVcodecLib()", say y.

config  HI_VDEC_MJPEG_SUPPORT
	bool "Motion JPEG Decoder Support"
	default n
	help
		If you want to use decode Motion JPEG stream, say y.

config  HI_VDEC_USERDATA_CC_SUPPORT
	bool "Closed Caption User Data Support"
	default y
	help
		If you want to receive closed caption user data, say y.

config  HI_VDEC_USERDATA_CC_BUFSIZE
	hex "Closed Caption User Data Buffer Size(0x4000~0x40000)"
	depends on HI_VDEC_USERDATA_CC_SUPPORT
	range 0x4000 0x40000
	default 0xC000
	help
		Closed caption user data buffer size. Recommend 0xC000.
	
config HI_VDEC_DFS_SUPPORT
	bool "Dynamic Frame Store Support"
	default n
	help
		if you want to use this feature, say y.

config HI_VDEC_PRE_ALLOC_VDHMMZ_SUPPORT
	bool "pre alloc video decoder frame buffer support"
	default n
	help
		if you want to use this feature, say y.
endmenu
#+++++++++++++++++++++++++++++++++++++++++++++++++++
```

## HiSTBLinuxV100R005C00SPC041B020/scripts/kconfig/Kconfig.vdec.mem2048
```kconfig
menu "Video Memory Config In 2048M DDR"
    depends on !(HI3716MV410 || HI3716MV420)

choice
    prompt "Capability for reserve memory"
    default HI_VIDEO_PRE_CAP_4K_IN_2048
config  HI_VIDEO_PRE_CAP_1080P_IN_2048
    bool "1080P"
config  HI_VIDEO_PRE_CAP_MVC_IN_2048
    bool "MVC"
config  HI_VIDEO_PRE_CAP_2160P_IN_2048
    bool "2160P"
config  HI_VIDEO_PRE_CAP_4K_IN_2048
    bool "4K"
endchoice

config HI_VIDEO_MAX_REF_FRAME_NUM_IN_2048
    int "Max reference frame number(3-16)"
    range 3 16
    default 6

config HI_VIDEO_MAX_DISP_FRAME_NUM_IN_2048
    int "Extra frame number for schedule(2-16)"
    range 2 16
    default 6

config HI_VIDEO_MAX_VDH_BUF_IN_2048
    int "Max VDH buffer for one decoder(20M-300M)"
    range 20 300
    default 250
endmenu
```

## HiSTBLinuxV100R005C00SPC041B020/scripts/kconfig/Kconfig.vdec.mem256
```kconfig
menu "Video Memory Config In 256M DDR"
    depends on !(HI3716MV410 || HI3716MV420)

choice
    prompt "Capability for reserve memory"
    default HI_VIDEO_PRE_CAP_1080P_IN_256
config  HI_VIDEO_PRE_CAP_1080P_IN_256
    bool "1080P"
config  HI_VIDEO_PRE_CAP_MVC_IN_256
    bool "MVC"
config  HI_VIDEO_PRE_CAP_2160P_IN_256
    bool "2160P"
config  HI_VIDEO_PRE_CAP_4K_IN_256
    bool "4K"
endchoice

config HI_VIDEO_MAX_REF_FRAME_NUM_IN_256
    int "Max reference frame number(3-16)"
    range 3 16
    default 7

config HI_VIDEO_MAX_DISP_FRAME_NUM_IN_256
    int "Extra frame number for schedule(2-16)"
    range 2 16
    default 2

config HI_VIDEO_MAX_VDH_BUF_IN_256
    int "Max VDH buffer for one decoder(20M-120M)"
    range 20 120
    default 110
endmenu
```

## HiSTBLinuxV100R005C00SPC041B020/scripts/kconfig/Kconfig.vdec.mem512
```kconfig
menu "Video Memory Config In 512M DDR"
    depends on !(HI3716MV410 || HI3716MV420)

choice
    prompt "Capability for reserve memory"
    default HI_VIDEO_PRE_CAP_MVC_IN_512
config  HI_VIDEO_PRE_CAP_1080P_IN_512
    bool "1080P"
config  HI_VIDEO_PRE_CAP_MVC_IN_512
    bool "MVC"
config  HI_VIDEO_PRE_CAP_2160P_IN_512
    bool "2160P"
config  HI_VIDEO_PRE_CAP_4K_IN_512
    bool "4K"
endchoice

config HI_VIDEO_MAX_REF_FRAME_NUM_IN_512
    int "Max reference frame number(3-16)"
    range 3 16
    default 7

config HI_VIDEO_MAX_DISP_FRAME_NUM_IN_512
    int "Extra frame number for schedule(2-16)"
    range 2 16
    default 2

config HI_VIDEO_MAX_VDH_BUF_IN_512
    int "Max VDH buffer for one decoder(20M-300M)"
    range 20 300
    default 110
endmenu
```
