## HiSTBLinuxV100R005C00SPC041B020/scripts/kconfig/Kconfig.vdec.mem768
```kconfig
menu "Video Memory Config In 768M DDR"
    depends on !(HI3716MV410 || HI3716MV420)

choice
    prompt "Capability for reserve memory"
    default HI_VIDEO_PRE_CAP_4K_IN_768
config  HI_VIDEO_PRE_CAP_1080P_IN_768
    bool "1080P"
config  HI_VIDEO_PRE_CAP_MVC_IN_768
    bool "MVC"
config  HI_VIDEO_PRE_CAP_2160P_IN_768
    bool "2160P"
config  HI_VIDEO_PRE_CAP_4K_IN_768
    bool "4K"
endchoice

config HI_VIDEO_MAX_REF_FRAME_NUM_IN_768
    int "Max reference frame number(3-16)"
    range 3 16
    default 5

config HI_VIDEO_MAX_DISP_FRAME_NUM_IN_768
    int "Extra frame number for schedule(2-16)"
    range 2 16
    default 4

config HI_VIDEO_MAX_VDH_BUF_IN_768
    int "Max VDH buffer for one decoder(20M-300M)"
    range 20 300
    default 180
endmenu
```

## HiSTBLinuxV100R005C00SPC041B020/scripts/kconfig/Kconfig.venc
```kconfig
config  HI_VENC_SUPPORT
	bool "VENC Support" 
	default n
	help
	    this option should be chosen on transcode scene
```

## HiSTBLinuxV100R005C00SPC041B020/scripts/kconfig/Kconfig.vi
```kconfig
config  HI_VI_SUPPORT
    bool "VI Support"
    default n

config  HI_VI_BT656_HIGH8
    bool "VI BT656 selection High 8bit"
    depends on HI_VI_SUPPORT
    default n
```

## HiSTBLinuxV100R005C00SPC041B020/scripts/kconfig/Kconfig.vo
```kconfig
#+++++++++++++++++++++++++++++++++++++++++++++++++++
menu "VO Config"
choice
	prompt "Video Buffer Type"
	default HI_VIDEO_BUFF_DEMO

config  HI_VIDEO_BUFF_DEMO
	bool "FMS6141 + FMS6363"

config  HI_VIDEO_BUFF_TYPE0
	bool "FMS6143a + FMS6363"
endchoice

config	HI_DISP_USE_QPLL_SOLELY
	bool "QPLL Be Used By Display Solely"
	help
	  If you select true, QPLL should be used by Display solely.
	  As a result display can suppport dobuble HD output with different pixel clock.
	default n

config	HI_DISP_TTX_INBUFFERSIZE
	hex "TTX Input Buffer Size"
	help
	  You can adjust teletext input buffer size if you need.
	default 0x4000

config	HI_DISP_CC_INBUFFERSIZE
	hex "SD CC Input Buffer Size"
	help
	  You can adjust Closed Caption input buffer size if you need.
	default 0x4000

config  HI_VDP_VIDEO_LINEDCMP
    bool
    depends on (HI3716MV410 || HI3716MV420)
    default y

config  HI_PQ_V3_0
	bool
	depends on HI3798MV100 || HI3796MV100 || HI3716DV100 || HI3716MV410 || HI3716MV420
	default y

config  HI_PQ_V4_0
	bool
	depends on HI3798CV200 || HI3798MV200 || HI3798MV200_A || HI3796MV200
	default y

config	HI_DISP_VIRT_OFFSET_EFFECT_WHEN_FULLSCREEN
	bool "disp offset take effect when window full screen."
	default n if ANDROID_PRODUCT
	default n if LINUX_PRODUCT
	help
	  If you select true, when window is full size,it also be effected by display offset.

endmenu
#+++++++++++++++++++++++++++++++++++++++++++++++++++
```

## HiSTBLinuxV100R005C00SPC041B020/scripts/kconfig/Kconfig.vp
```kconfig
#+++++++++++++++++++++++++++++++++++++++++++++++++++
#menu "VP Config"
#--------------------------------

config  HI_VP_SUPPORT
	depends on HI_VI_SUPPORT && HI_VENC_SUPPORT && !HI_VO_SINGLE_VIDEO_SUPPORT && HI_VDEC_MJPEG_SUPPORT
	bool "VP Support" 
	default n

#endmenu
#+++++++++++++++++++++++++++++++++++++++++++++++++++
```

## HiSTBLinuxV100R005C00SPC041B020/scripts/kconfig/Kconfig.vpss
```kconfig
#+++++++++++++++++++++++++++++++++++++++++++++++++++
menu "VPSS Config"
config  HI_VPSS_MAX_BUFFER_NUMB
	int "Vpss Port OutBuffer Max  Number(6~20)"
	range 6 20
	default 10
endmenu
#+++++++++++++++++++++++++++++++++++++++++++++++++++
```

## HiSTBLinuxV100R005C00SPC041B020/scripts/kconfig/Kconfig.wifi
```kconfig
#+++++++++++++++++++++++++++++++++++++++++++++++++++
#--------------------------------
menuconfig HI_WIFI_SUPPORT
	bool "WiFi Support"
	default n
	depends on LINUX_PRODUCT
	help
	  This section contains all the supported 802.11 wireless device drivers.
	  Set to 'y' to support this device, 'n' not support.

menu    "WiFi Device Type"
	depends on HI_WIFI_SUPPORT

config  HI_WIFI_DEVICE_RTL8188EUS
	bool "Realtek RTL8188ETV and RTL8188EUS (11n 1x1 2.4G USB)"

config  HI_WIFI_DEVICE_RTL8192EU
	bool "Realtek RTL8192EU (11n 2x2 2.4G USB)"
	depends on (HI3798MV100 || HI3796MV100 || HI3716DV100 || (HI3798CV200 && HI_32BIT_SYSTEM) || (HI3798MV200 && HI_32BIT_SYSTEM))

config  HI_WIFI_DEVICE_RTL8812AU
	bool "Realtek RTL8812AU (11ac 2x2 5G USB)"
	depends on (HI3798MV100 || HI3796MV100 || HI3716DV100 || (HI3798CV200 && HI_32BIT_SYSTEM) || (HI3798MV200 && HI_32BIT_SYSTEM))

config  HI_WIFI_DEVICE_RTL8723BU
	bool "Realtek RTL8723BU (11n 1x1 2.4G USB + BT4.0)"
	depends on (HI3798MV100 || HI3796MV100 || HI3716DV100 || (HI3798CV200 && HI_32BIT_SYSTEM) || (HI3798MV200 && HI_32BIT_SYSTEM))

config  HI_WIFI_DEVICE_RTL8822BU
	bool "Realtek RTL8822BU (11ac 2x2 5G USB)"
	depends on (HI3798MV100 || HI3796MV100 || HI3716DV100 || (HI3798CV200 && HI_32BIT_SYSTEM) || (HI3798MV200 && HI_32BIT_SYSTEM))

config  HI_WIFI_DEVICE_RTL8821AU
	bool "Realtek RTL8821AU (11ac 1x1 5G USB + BT4.0)"
	depends on (HI3798MV100 || HI3796MV100 || HI3716DV100 || (HI3798CV200 && HI_32BIT_SYSTEM))

config  HI_WIFI_DEVICE_MT76X2U
	bool "Mediatek MT7662TU and MT7632TU (2x2 USB + BT4.0)"
	depends on (HI3798MV100 || HI3796MV100 || HI3716DV100 || (HI3798CV200 && HI_32BIT_SYSTEM) || (HI3798MV200 && HI_32BIT_SYSTEM))

config  HI_WIFI_DEVICE_MT7662TE
	bool "Mediatek MT7662TE (11ac 2x2 5G USB + BT4.0)(PCI-e interface)"
	depends on (HI3798MV100 || HI3796MV100 || HI3716DV100 || (HI3798CV200 && HI_32BIT_SYSTEM) || (HI3798MV200 && HI_32BIT_SYSTEM))

#config  HI_WIFI_DEVICE_MT7601U
#	bool "Mediatek MT7601U (11n 1x1 2.4G USB)"
#	depends on (HI3798MV100 || HI3796MV100 || HI3716DV100)

#config  HI_WIFI_DEVICE_RT5572
#	bool "Mediatek RT5572 (11n 2x2 2.4G+5G USB)"
#	depends on (HI3798MV100 || HI3796MV100 || HI3716DV100)

endmenu

menu	"WiFi Working Mode"
	depends on HI_WIFI_SUPPORT

config  HI_WIFI_MODE_STA
	bool "STA Mode"

config  HI_WIFI_MODE_AP
	bool "SoftAP Mode"
endmenu
```

## HiSTBLinuxV100R005C00SPC041B020/source/component/wifi/drv/pcie_rtl8192ee/rtl8192EE_linux_v4.3.15.1_19180_BTCOEX20150615-0041.20160824/Kconfig
```kconfig
config RTL8192EE
	tristate "Realtek 8192E PCI WiFi"
	depends on PCI
	---help---
	  Help message of RTL8192EE
```

## HiSTBLinuxV100R005C00SPC041B020/source/component/wifi/drv/usb_mt76x2u/JEDI.MP2.mt76x2u.wifi.v3.3.1/Kconfig
```kconfig
config RLT_WIFI
	tristate "RLT WIFI Driver"
	select WIFI_BASIC_FUNC if RLT_WIFI

if RLT_WIFI
menu "WiFi Generic Feature Options"
choice
        prompt "EEPROM Type of 1st Card"
        depends on ! FIRST_IF_NONE

        config FIRST_IF_EEPROM_PROM
        bool "EEPROM"

        config FIRST_IF_EEPROM_EFUSE
        bool "EFUSE"

        config FIRST_IF_EEPROM_FLASH
        bool "FLASH"
endchoice

config RT_FIRST_CARD_EEPROM
        string
        depends on ! FIRST_IF_NONE
        default "prom" if FIRST_IF_EEPROM_PROM
        default "efuse" if FIRST_IF_EEPROM_EFUSE
        default "flash" if FIRST_IF_EEPROM_FLASH

choice
        prompt "EEPROM Type of 2nd Card"
        depends on ! SECOND_IF_NONE

        config SECOND_IF_EEPROM_PROM
        bool "EEPROM"

        config SECOND_IF_EEPROM_EFUSE
        bool "EFUSE"

        config SECOND_IF_EEPROM_FLASH
        bool "FLASH"
endchoice

config RT_SECOND_CARD_EEPROM
        string
        depends on ! SECOND_IF_NONE
        default "prom" if SECOND_IF_EEPROM_PROM
        default "efuse" if SECOND_IF_EEPROM_EFUSE
        default "flash" if SECOND_IF_EEPROM_FLASH
		
config MULTI_INF_SUPPORT
        bool
        default y if !FIRST_IF_NONE && !SECOND_IF_NONE
		
config WIFI_BASIC_FUNC
	bool "Basic Functions"
	select WIRELESS_EXT
	select WEXT_SPY
	select WEXT_PRIV
        
config WSC_INCLUDED
	bool "WSC(WiFi Simple Config)"
	depends on WIFI_DRIVER
    	default y

config WSC_V2_SUPPORT
	bool "WSC V2(WiFi Simple Config Version 2.0)"
	depends on WIFI_DRIVER
    	default y

config WSC_NFC_SUPPORT
	bool "WSC out-of-band(NFC)"
        depends on WIFI_DRIVER
    	default n
    
config DOT11_VHT_AC
	bool "802.11ac"
	depends on WIFI_DRIVER
    	default n
    
config DOT11W_PMF_SUPPORT
	bool "PMF Support"
	depends on WIFI_DRIVER
    	default n

config TXBF_SUPPORT
    	bool "Tx Bean Forming Support"
    	depends on WIFI_DRIVER
    	default n

#config WMM_ACM_SUPPORT
#	bool "WMM ACM"
#	depends on WIFI_DRIVER
#   	default n
	
config LLTD_SUPPORT
	bool "LLTD (Link Layer Topology Discovery Protocol)"
	depends on WIFI_DRIVER
    	default n

config QOS_DLS_SUPPORT
	bool "802.11e DLS ((Direct-Link Setup) Support"
	depends on WIFI_DRIVER
    	default n

config WAPI_SUPPORT
	bool "WAPI Support"
	depends on WIFI_DRIVER
    	default n

config CARRIER_DETECTION_SUPPORT
	bool "Carrier Detect"
	depends on WIFI_DRIVER
    	default n

config ED_MONITOR_SUPPORT
        bool "ED CCA Monitor Support"
        depends on WIFI_DRIVER
        default n

config IGMP_SNOOP_SUPPORT
	bool "IGMP Snooping"
	depends on WIFI_DRIVER
    	default n

config BLOCK_NET_IF
	bool "NETIF Block"
	depends on WIFI_DRIVER
    	default n

#config VIDEO_TURBINE_SUPPORT
#	bool "Video Turbine support"
#	depends on WIFI_DRIVER
#   	default n

#config RA_CLASSIFIER
#	tristate "Ralink Flow Classifier"
#	depends on WIFI_DRIVER
#	default n

config RATE_ADAPTION
    	bool "New Rate Adaptation Support"
    	depends on WIFI_DRIVER
    	default n

config NEW_RATE_ADAPT_SUPPORT
    	bool "Intelligent Rate Adaption"
	depends on RATE_ADAPTION
    	depends on WIFI_DRIVER
    	default y

config AGS_SUPPORT
	bool "Adaptive Group Switching"
	depends on RATE_ADAPTION
	depends on WIFI_DRIVER
    	default n
    
config IDS_SUPPORT
	bool "IDS(Intrusion Detection System) Support"
	depends on WIFI_DRIVER
    	default n

config WIFI_WORK_QUEUE
	bool "Work Queue"
	depends on WIFI_DRIVER
    	default n

config WIFI_SKB_RECYCLE
    	bool "SKB Recycle(Linux)"
    	depends on WIFI_DRIVER
    	default n

config RTMP_FLASH_SUPPORT
	bool "Flash Support"
	depends on WIFI_DRIVER
    	default n

config LED_CONTROL_SUPPORT
	bool "LED Control Support"
	depends on WIFI_DRIVER
    	default n

config SINGLE_SKU_V2
    	bool "Single SKU V2"
    	depends on WIFI_DRIVER || RALINK_RT6352
    	default n

config HW_ANTENNA_DIVERSITY
	bool "Antenna Diversity Support"
	depends on RLT_AP_SUPPORT || RLT_STA_SUPPORT
	depends on RALINK_RT5350
    	default n

config ATE_SUPPORT
	bool "ATE/QA Support"
	depends on WIFI_DRIVER
    	default n

config  RT2860V2_AP_32B_DESC
	bool "32 Byte Descriptor Support"
	depends on WIFI_DRIVER
	depends on RALINK_RT6352 || RALINK_MT7620
	default n

config RT2860V2_AP_MEMORY_OPTIMIZATION
	bool "Memory Optimization"
	depends on WIFI_DRIVER
    	default n

config RTMP_INTERNAL_TX_ALC
    	bool "TSSI Compensation"
    	depends on WIFI_DRIVER
    	depends on RALINK_RT3350 || RALINK_RT3352 || RALINK_RT5350 || RALINK_RT6352
	default n
    
config RTMP_TEMPERATURE_COMPENSATION
    	bool "Temperature Compensation"
    	depends on WIFI_DRIVER
    	depends on RALINK_RT6352
    	default n

config RTMP_THERMAL_PROTECT
    	bool "Thermal Protect Support"
    	depends on WIFI_DRIVER
    	depends on RALINK_RT6352
    	default n

config HOTSPOT
	bool "Passpoint-R1 Support"
	depends on WIFI_DRIVER
    	default n

config CO_CLOCK_SUPPORT
        bool "co-clock Support"
        depends on WIFI_DRIVER
    	default n

menu "PA/LNA Settings of 1st Card"
config FIRST_CARD_EXTERNAL_PA
        bool "External Power Amplifier(PA)"
        depends on WIFI_DRIVER
    default n

config FIRST_CARD_EXTERNAL_LNA
        bool "External Low-Noise Amplifier(LNA)"
        depends on WIFI_DRIVER
    default n
endmenu

menu "PA/LNA Settings of 2nd Card"
config SECOND_CARD_EXTERNAL_PA
        bool "External Power Amplifier(PA)"
        depends on WIFI_DRIVER
    default n

config SECOND_CARD_EXTERNAL_LNA
        bool "External Low-Noise Amplifier(LNA)"
        depends on WIFI_DRIVER
    default n
endmenu

#
# Section for chip architectures
#
# "RLT MAC Support"
#config RLT_MAC
#	bool
#	depends on WIFI_DRIVER
#    	default n

config RLT_BBP
    	bool

config RLT_RF
    	bool

# "RTMP MAC Support"
config RTMP_MAC
	bool
	depends on WIFI_DRIVER
    	default n

config RTMP_BBP
    	bool

config RTMP_RF
    	bool

#
# Section for interfaces
#
config RTMP_PCI_SUPPORT
    	bool

config RTMP_USB_SUPPORT
    	bool

config RTMP_RBUS_SUPPORT
    	bool

endmenu

menu "WiFi Operation Modes"
    choice
        prompt "Main Mode"
        default WIFI_MODE_AP

        config WIFI_MODE_AP
                bool "AP"

        config WIFI_MODE_STA
                bool "STA"

        config WIFI_MODE_BOTH
                bool "APSTA"
    endchoice

    if WIFI_MODE_AP || WIFI_MODE_BOTH
        source "drivers/net/wireless/rlt_wifi_ap/Kconfig"
    endif

    if WIFI_MODE_STA || WIFI_MODE_BOTH
        source "drivers/net/wireless/rlt_wifi_sta/Kconfig"
    endif
endmenu	

#"RT2860 series"
config RALINK_RT28XX
        bool
        default n
        select RTMP_PCI_SUPPORT

#"RT3092"
config RALINK_RT3092
        bool
        default n
        select RTMP_PCI_SUPPORT

#"RT3572"
config RALINK_RT3572
        bool
        default n
        select RTMP_USB_SUPPORT

#"RT5392"
config RALINK_RT5392
        bool
        default n
        select RTMP_PCI_SUPPORT

#"RT5572"
config RALINK_RT5572
        bool
        default n
        select RTMP_USB_SUPPORT

#"RT5592"
config RALINK_RT5592
        bool
        default n
        select RTMP_PCI_SUPPORT

#"MT7620/RT6352"
config RALINK_RT6352
        bool
        default n
        select RTMP_RBUS_SUPPORT
#        select RTMP_TEMPERATURE_CALIBRATION
#        select RTMP_INTERNAL_TX_ALC

#"MT7610E"
config RALINK_MT7610E
        bool
        default n
        select RTMP_PCI_SUPPORT

#"MT7610U"
config RALINK_MT7610U
        bool
        default n
        select RTMP_USB_SUPPORT

#"RT8592"
config RALINK_RT8592
        bool
        default n
        select RTMP_PCI_SUPPORT

#"MT7612E"
config RALINK_MT7612E
        bool
        default n
        select RTMP_PCI_SUPPORT

#"MT7612U"
config RALINK_MT7612U
        bool
        default n
        select RTMP_USB_SUPPORT

endif

if RALINK_MT7602E || RALINK_MT7612E
	config RLT_MAC
		bool
		default y
endif
```
