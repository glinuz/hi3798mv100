## HiSTBLinuxV100R005C00SPC041B020/source/kernel/linux-3.18.y/arch/arm/mach-hi3798mv2x/Kconfig
```kconfig
if ARCH_HI3798MV2X
menu "HI3798MV2X board feature"

config MACH_HI3798MV2X
	bool "Support hi3798mv2x platform"
	select CPU_V7
	select ARM_GIC
	select ARM_TIMER_SP804
	select COMMON_CLK
	select ARCH_REQUIRE_GPIOLIB
	select DYNAMIC_DEBUG
	help
	  Include support for the hisilion HI3798MV2X platform.
	  HI3798MV2X support ARM CORTEX-A7 processer,
	  within a Generic Interrupt Controller.
	  Support DDR2 and DDR3.

choice
	prompt "CPU timer source"
	default HAVE_SP804_LOCAL_TIMER_HI3798MV2X

config HAVE_SP804_LOCAL_TIMER_HI3798MV2X
	bool "arm local timer from sp804"
	help
	  arm local timer from sp804.

config HAVE_ARM_LOCAL_TIMER_HI3798MV2X
	bool "arm local timer from arm self"
	help
	  arm local timer from arm self.
endchoice

config DEFAULT_UART_BASE_ADDR
	hex "Default uart controller base address"
	default "0xF8B00000"
	help
	  Default UART controller base address

config DEFAULT_VMALLOC_SIZE
	int "Default vmalloc size"
	default 500
	help
	  Default vmalloc size in MBytes. Use "vmalloc=size" to change it.

menuconfig SUPPORT_DSP_RUN_MEM
	bool "Support DSP run memory"
	default y
	help
	  Support DSP run memory

config DSP_RUN_MEM_ADDR
	hex "DSP run memory address"
	depends on SUPPORT_DSP_RUN_MEM
	default "0x2000000"
	help
	  The start address of DSP run memory.

config DSP_RUN_MEM_SIZE
	hex "DSP run memory size"
	depends on SUPPORT_DSP_RUN_MEM
	default "0x800000"
	help
	  The size of DSP run memory.

config HI3798MV2X_FPGA
	bool "Enable HI3798MV2X Fpga config"
	default n if ARCH_HI3798MV2X

endmenu
endif
```

## HiSTBLinuxV100R005C00SPC041B020/source/kernel/linux-3.18.y/arch/arm/mach-s40/Kconfig
```kconfig
menu "S40 board feature"

config MACH_S40
	bool "Support s40 platform"
	select CPU_V7
	select ARM_GIC
	select ARM_TIMER_SP804
	select COMMON_CLK
	select ARCH_REQUIRE_GPIOLIB
	select DYNAMIC_DEBUG
	help
	  Include support for the hisilion S40 platform.
	  S40 support ARM CORTEX-A9 processer,
	  within a Generic Interrupt Controller.
	  Support DDR2 and DDR3.

config DEFAULT_UART_BASE_ADDR
	hex "Default uart controller base address"
	default "0xF8B00000"
	help
	  Default UART controller base address

config DEFAULT_VMALLOC_SIZE
	int "Default vmalloc size"
	default 240
	help
	  Default vmalloc size in MBytes. Use "vmalloc=size" to change it.

menuconfig SUPPORT_DSP_RUN_MEM
	bool "Support DSP run memory"
	default y
	help 
	  Support DSP run memory

config DSP_RUN_MEM_ADDR
	hex "DSP run memory address"
	depends on SUPPORT_DSP_RUN_MEM
	default "0x2000000" 
	help
	  The start address of DSP run memory.

config DSP_RUN_MEM_SIZE
	hex "DSP run memory size"
	depends on SUPPORT_DSP_RUN_MEM
	default "0x800000"
	help
	  The size of DSP run memory.

endmenu
```

## HiSTBLinuxV100R005C00SPC041B020/source/kernel/linux-3.18.y/drivers/cpufreq/Kconfig.hisilicon
```kconfig
config MICRO_FREQUENCY_UP_THRESHOLD
	int "Micro frequency up threshold"
	default 80 if (ARCH_S40 || ARCH_HI3798MX || ARCH_HI3798CV2X || ARCH_HI3798MV2X || ARCH_HI3796MV2X)
	default 95

config DEFAULT_GO_HISPEED_LOAD
	int "Default go hispeed load"
	default 80 if (ARCH_S40 || ARCH_HI3798MX || ARCH_HI3798CV2X || ARCH_HI3798MV2X || ARCH_HI3796MV2X)
	default 99
	help 
	  Go to hi speed when CPU load at or above this value.

config DEFAULT_TARGET_LOAD
	int "Default target load"
	default 70 if (ARCH_S40 || ARCH_HI3798MX || ARCH_HI3798CV2X || ARCH_HI3798MV2X || ARCH_HI3796MV2X)
	default 90
	help
	  Target load, lower values result in higher CPU speeds.
```

## HiSTBLinuxV100R005C00SPC041B020/source/kernel/linux-3.18.y/drivers/hisilicon/Kconfig
```kconfig
menu "Hisilicon driver support"

config VIRTUAL_INPUT
	tristate "virtual input device for android"
	help
	  If you say yes here you get support for android.

source "drivers/hisilicon/ir/Kconfig"
source "drivers/hisilicon/kapi/Kconfig"
source "drivers/hisilicon/misc/Kconfig"
source "drivers/hisilicon/Kconfig.ca"
source "drivers/hisilicon/cma/Kconfig"
source "drivers/hisilicon/usbotg/Kconfig"
source "drivers/hisilicon/soc/Kconfig"
source "drivers/hisilicon/sdcardfs/Kconfig"
source "drivers/hisilicon/tee/Kconfig"
source "drivers/hisilicon/regulator/Kconfig"

menu "Hisilicon thermal drivers"
source "drivers/hisilicon/ipa/Kconfig"
endmenu

source "drivers/hisilicon/hash_vrf_dev/Kconfig"

endmenu
```

## HiSTBLinuxV100R005C00SPC041B020/source/kernel/linux-3.18.y/drivers/hisilicon/Kconfig.ca
```kconfig
menuconfig SUPPORT_CA
	bool "Support CA"
	default n
	help
	  If support ca, user privileges will be limit.
	  select y, support ca, otherwise not support ca.

config CA_SUPPORT_ADVCA
	bool "Support advca"
	depends on SUPPORT_CA
	select CA_NET_CONFIG
	select CA_FILE_AUTHORITY
	default n
	help
	  support advca, which is the real CA.

config CA_WARKUP_CHECK
	bool "Support CA wakeup ddr check"
	depends on SUPPORT_CA
	default n
	help
	  support ca suspend get hash value, and wakeup check ddr.

config CA_FILE_AUTHORITY
	bool
	default n
	help
	  support advca file authority.

config CA_NET_CONFIG
	bool
	default n
	help
	  support advca net config.
```

## HiSTBLinuxV100R005C00SPC041B020/source/kernel/linux-3.18.y/drivers/hisilicon/cma/Kconfig
```kconfig
config CMA_MEM_SHARED
	bool "Support sharing CMA memory with the heap"
	depends on CMA && DMA_CMA
	default no
	help
	  Support sharing CMA memory with the heap.

config CMA_ADVANCE_SHARE
	bool "Support cma advance share"
	depends on CMA && DMA_CMA
	select CMA_MEM_SHARED
	default no
	help
	  Support advance sharing CMA memory with the heap.
	  CMA Multiplex Ratio will be improved when this macro defined.
```

## HiSTBLinuxV100R005C00SPC041B020/source/kernel/linux-3.18.y/drivers/hisilicon/hash_vrf_dev/Kconfig
```kconfig
menuconfig HASH_VRF_DEV
	bool "Support Hash Verification Block Device"
	default n
	help
	  If say y, Hash Verification Block Device is supported
```

## HiSTBLinuxV100R005C00SPC041B020/source/kernel/linux-3.18.y/drivers/hisilicon/ipa/Kconfig
```kconfig
config HISI_THERMAL
	tristate "Hisilicon thermal driver"
	depends on OF && CPU_FREQ
	help
	  Enable this to plug hisilicon's thermal sensor driver into the Linux
	  thermal framework. cpufreq is used as the cooling device to throttle
	  CPUs when the passive trip is crossed.
```

## HiSTBLinuxV100R005C00SPC041B020/source/kernel/linux-3.18.y/drivers/hisilicon/ir/Kconfig
```kconfig
menu "Hisilicon IR drivers"
config HISI_IR
	tristate "Hisilicon IR remote control"
	select MEDIA_SUPPORT
	select MEDIA_RC_SUPPORT
	select RC_DECODERS
	select RC_DEVICES
	select RC_CORE
	select INPUT
	default n
	---help---
	   Say Y here if you want to use hisilicon remote control.

if RC_DECODERS
config IR_NEC_2HDR_40BIT_DECODER
	tristate "Enable IR raw decoder for the NEC 2 head 40bit protocol"
	depends on RC_CORE
	select BITREVERSE
	default y
	---help---
	   Enable this option if you have IR with NEC protocol, and
	   if the IR is decoded in software

config IR_NEC_FULL_40BIT_DECODER
	tristate "Enable IR raw decoder for the NEC full 40bit protocol"
	depends on RC_CORE
	select BITREVERSE
	default y
	---help---
	   Enable this option if you have IR with NEC protocol, and
	   if the IR is decoded in software

config IR_NEC_FULL_48BIT_DECODER
	tristate "Enable IR raw decoder for the NEC full 48bit protocol"
	depends on RC_CORE
	select BITREVERSE
	default y
	---help---
	   Enable this option if you have IR with NEC protocol, and
	   if the IR is decoded in software

endif #RC_DECODERS

if HISI_IR
menu "Hisilicon IR key map driver"

config HISI_IR_NEC_SIMPLE_2HDR_GD
	tristate "GuangDong nec simple 2 headers(U hudong)"
	default m

config HISI_IR_NEC_SIMPLE_UPD61261
	tristate "uPD61216 nec simple"
	default m

config HISI_NEC_FULL_DEZHOU
	tristate "DeZhou nec full"
	default m

config HISI_NEC_FULL_BANK
	tristate "YinLian nec full"
	default m


config HISI_NEC_SIMPLE_HISILICON
	tristate "hisilicon nec simple"
	default m

config HISI_NEC_SIMPLE_BLACK
	tristate "Black nec simple"
	default m

config HISI_NEC_TC9012
	tristate "TC9012 nec simple"
	default m

config HISI_EXTENDED_RC5_DONGFANG
	tristate "DongFang YouXian rc-5 14bits"
	default m

config HISI_SONY
	tristate "Sony d745"
	default m

config HISI_RC5_14BIT_SKYWORTH
	tristate "Skyworth rc-5 14bits"
	default m

config HISI_RC5_14BIT_LUFENG
	tristate "LuFeng rc-5 14bits"
	default m

config HISI_RC6_16BIT_PHILIPS
	tristate "Philips rc-6 16bits"
	default m

config HISI_RC6_32BIT_BGCTV
	tristate "BGCTV rc-6 32bits"
	default m

endmenu #HISI_IR
endif #HISI_IR

endmenu #HISI_IR
```

## HiSTBLinuxV100R005C00SPC041B020/source/kernel/linux-3.18.y/drivers/hisilicon/kapi/Kconfig
```kconfig
menuconfig SUPPORT_SRAM_MANAGER
	bool "SRAM manager suppport"
	default n
	select GENERIC_ALLOCATOR
	help
	  If say y, SRAM manager is supported

config SRAM_PHYS_START
	hex "SRAM physical address"
	default "0xFFFF2800"
	depends on SUPPORT_SRAM_MANAGER
	help
	  SRAM physical address

config SRAM_PHYS_SIZE
	hex "SRAM size"
	default "0x00002800"
	depends on SUPPORT_SRAM_MANAGER
	help
	  SRAM size
```

## HiSTBLinuxV100R005C00SPC041B020/source/kernel/linux-3.18.y/drivers/hisilicon/misc/Kconfig
```kconfig
config MTD_BLOCK_ROMBLOCK
	tristate "Readonly(romblock) block device access to MTD devices"
	depends on BLOCK
	select MTD_BLKDEVS
	default y
	help
	  Same as readonly block driver, but this allow you to mount read-only
	  file systems from an MTD device, containing bad blocks.

config PART_CHANGE
	bool "Support change partition by file '/proc/partchange'"
	default y
	select BLK_CMDLINE_PARSER
	select CMDLINE_PARTITION
	---help---
	  Support change partition by file '/proc/partchange'

config HI_I2C
	tristate "Hisilicon high-speed I2C devices"
	default n
	depends on I2C
	help
	Say Y here to include support for Hisilicon high-speed I2C controller.

	This driver can also be built as a module.  If so, the module
	will be called hi-i2c.

config PAGEALLOC_LOCK
	bool "lock page when free page, and unlock page when alloc page"
	default n
	select DEBUG_PAGEALLOC
	help
	  for page alloc debug.
```

## HiSTBLinuxV100R005C00SPC041B020/source/kernel/linux-3.18.y/drivers/hisilicon/regulator/Kconfig
```kconfig
menuconfig REGULATOR
	bool "Voltage and Current Regulator Support"
	help
	  Generic Voltage and Current Regulator support.

	  This framework is designed to provide a generic interface to voltage
	  and current regulators within the Linux kernel. It's intended to
	  provide voltage and current control to client or consumer drivers and
	  also provide status information to user space applications through a
	  sysfs interface.

	  The intention is to allow systems to dynamically control regulator
	  output in order to save power and prolong battery life. This applies
	  to both voltage regulators (where voltage output is controllable) and
	  current sinks (where current output is controllable).

	  This framework safely compiles out if not selected so that client
	  drivers can still be used in systems with no software controllable
	  regulators.

	  If unsure, say no.


if REGULATOR

config REGULATOR_Hi3798CV200
	tristate "Hisilicon Hi3798CV200 regulators"
	help
	  This driver provides support for the voltage regulators on the
	  Hi3798CV200.
endif
```

## HiSTBLinuxV100R005C00SPC041B020/source/kernel/linux-3.18.y/drivers/hisilicon/soc/Kconfig
```kconfig
if ARCH_HI3798CV2X
source "drivers/hisilicon/soc/hi3798cv200/Kconfig"
endif

if ARCH_HI3798MV2X
source "drivers/hisilicon/soc/hi3798mv200/Kconfig"
endif
```

## HiSTBLinuxV100R005C00SPC041B020/source/kernel/linux-3.18.y/drivers/hisilicon/soc/hi3796mv200/Kconfig
```kconfig
config CPU_IDLE_HI3796MV200
	bool "CPU Idle Driver for Hisilicon Hi3796mv200 processors"
	depends on ARCH_HI3796MV200
	help
	  Select this to enable cpuidle on Hi3796mv200 processors.
```

## HiSTBLinuxV100R005C00SPC041B020/source/kernel/linux-3.18.y/drivers/hisilicon/soc/hi3798cv200/Kconfig
```kconfig
config CPU_IDLE_HI3798CV2X
	bool "CPU Idle Driver for Hisilicon Hi3798cv2x processors"
	depends on ARCH_HI3798CV2X
	help
	  Select this to enable cpuidle on Hi3798cv2x processors.
```

## HiSTBLinuxV100R005C00SPC041B020/source/kernel/linux-3.18.y/drivers/hisilicon/soc/hi3798mv200/Kconfig
```kconfig
config CPU_IDLE_HI3798MV2X
	bool "CPU Idle Driver for Hisilicon Hi3798mv2x processors"
	depends on ARCH_HI3798MV2X
	help
	  Select this to enable cpuidle on Hi3798mv2x processors.
```

## HiSTBLinuxV100R005C00SPC041B020/source/kernel/linux-3.18.y/drivers/hisilicon/tee/Kconfig
```kconfig
menuconfig  TEE
	tristate "Secure TEE driver"
	default n
	help
	 Provides a communication interface between userspace and
	 TrustZone Operating Environment.

config  TEE_HISI
	tristate "Trustedcore Secure TEE driver"
	default n
	depends on TEE
	help
	 Provides a communication interface between userspace and
	 TrustZone Operating Environment.

if TEE_HISI
source drivers/hisilicon/tee/tee_hisi/tzdriver/Kconfig
endif
```

## HiSTBLinuxV100R005C00SPC041B020/source/kernel/linux-3.18.y/drivers/hisilicon/tee/tee_hisi/tzdriver/Kconfig
```kconfig
menu "TEE OS"

config SECURE_EXTENSION
	bool "security extension support"
	default n
	help
	  Include Security Extension.

config  TZDRIVER
	tristate "Secure Execution Communicator driver"
	default n
	depends on SECURE_EXTENSION
	help
	  Provides a communication interface between userspace and
	  TrustZone Operating Environment.

config TEELOG
	tristate "Secure Execution Log driver"
	default n
	depends on TZDRIVER
	help
	  TEEOS log

config TEE_TUI
	tristate "Trusted user interface driver"
	default n
	depends on TZDRIVER
	help
	  Trusted user interface diver

#config IMAX_CIPHER
#	tristate "Imax cipher interface driver"
#	default n
#	depends on TZDRIVER
#	help
#	  Imax cipher interface diver

#config TEE_RANDOM
#	tristate "TEE based random driver"
#	default n
#	depends on TZDRIVER
#	help
#	  TEE based random diver

#config HISI_SPI_SMC
#	bool "hisi spi smc"
#	default n

#config HISI_SPI1_SMC
#	bool "hisi spi1 smc"
#	default n

config DEVCHIP_PLATFORM
	bool "when we are DEVCHIP PLATFORM"
	default n

#source drivers/hisi/tzdriver/ca_antiroot/Kconfig
source drivers/hisilicon/tee/tee_hisi/tzdriver/libhwsecurec/Kconfig

endmenu
```

## HiSTBLinuxV100R005C00SPC041B020/source/kernel/linux-3.18.y/drivers/hisilicon/tee/tee_hisi/tzdriver/ca_antiroot/Kconfig
```kconfig
#
# tee root scan client configuration
#

config TEE_ANTIROOT_CLIENT
        bool "A client to scan root status"
#        depends on HW_ROOT_SCAN
        default n
        help
           this is a TEE root scan client,
	   that use huawei root scan engine
	   to gather kernel info, and send to
	   TEE to verify kernel.


config HUAWEI_ROOT_SCAN_DUMMY_API
	bool "dummy api for test of TEE_ANTIROOT_CLIENT"
	depends on TEE_ANTIROOT_CLIENT
	default n
	help
	   this is dummy api for test of TEE_ANTIROOT_CLIENT.
	   It mimics the API of HW_ROOT_SCAN, so we
	   can test antiroot CA/TA.
	   SHOULD turn off this when HW_ROOT_SCAN is on.
```

## HiSTBLinuxV100R005C00SPC041B020/source/kernel/linux-3.18.y/drivers/hisilicon/tee/tee_hisi/tzdriver/libhwsecurec/Kconfig
```kconfig
#
# secure function configuration
#

config TEE_LIBHWSECUREC
	bool "Huawei secure c function library"
	default n
	help
		this is a secure f function for kernel
```

## HiSTBLinuxV100R005C00SPC041B020/source/kernel/linux-3.18.y/drivers/hisilicon/usbotg/Kconfig
```kconfig
config USB_OTG_HISI
	tristate "Hisilicon OTG driver support"
	default n
	help
	  Enable support for the Hisilicon USB OTG function.
```

## HiSTBLinuxV100R005C00SPC041B020/source/kernel/linux-3.18.y/drivers/mmc/host/himciv200/Kconfig
```kconfig
#
# himci v200 device configuration
#

config HIMCIV200_SDIO_SYNOPSYS 
	tristate "Himciv200 SDIO/MMC device support"
	depends on ARCH_S40 || ARCH_HI3798MX || ARCH_HIFONE || ARCH_HI3798CV2X || ARCH_HI3798MV2X
	default n if ARCH_S40
	select MMC_UNSAFE_RESUME
	select MMC_EMBEDDED_SDIO
	select MMC_BLOCK
	select MMC_BLOCK_BOUNCE
	help
	  This selects the mmc family device.
```
