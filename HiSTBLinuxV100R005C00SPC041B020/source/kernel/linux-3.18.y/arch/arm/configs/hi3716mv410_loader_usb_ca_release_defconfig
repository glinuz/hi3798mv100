## HiSTBLinuxV100R005C00SPC041B020/source/kernel/linux-3.18.y/drivers/mtd/devices/hisfc350/Kconfig
```kconfig
#
# hisilicon spi flash controller device version 350
#

menuconfig MTD_HISFC350
	tristate "hisilicon spi flash controller device version 350 driver"
	default n
	select MTD_SPI_IDS
	help
	  hisilicon spi flash controller device version 350.
```

## HiSTBLinuxV100R005C00SPC041B020/source/kernel/linux-3.18.y/drivers/mtd/hisilicon/Kconfig
```kconfig
config MTD_HIFMC100
	tristate "Hisilicon Flash Memory Controller Ver 100 support"
	default n
	select MTD_BLOCK
	help
	  Support Hisilicon Flash Memory Controller Version 100.
```
