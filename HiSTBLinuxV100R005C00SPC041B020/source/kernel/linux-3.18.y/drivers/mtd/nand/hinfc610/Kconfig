## HiSTBLinuxV100R005C00SPC041B020/source/kernel/linux-3.18.y/drivers/mtd/nand/hinfc610/Kconfig
```kconfig
#
# drivers/mtd/nand/hinfc610/Kconfig
# add by caizhiyong 2010.11.04
#

menuconfig MTD_NAND_HINFC610
	tristate "Hisilicon NAND Controller v610 device Support"
	depends on MTD_NAND
	default y if (ARCH_S40) || (ARCH_GODBOX) || (ARCH_HI3798MX) || (ARCH_HIFONE)
	select MISC_FILESYSTEMS
	select MTD_BLOCK
	help
	  Hisilicon NAND Controller v610 device Support

if MTD_NAND_HINFC610

config HINFC610_MAX_CHIP
	int "number of nand flash chip (1,4)"
	default 1
	help
	  nand controller v610 device only support 1 or 2 nand flash chip,
	  your should not config other value.

config HINFC610_CACHE_ENABLE
	bool "enable nand cache feature"
	default n
	help
	  enable cache feature may improve nand startup speed on some file system

config HINFC610_DBG_NAND_DEBUG
	bool "Debug: create debug file to control debug type"
	default y
	help
	  Create "debug" file to control debug type.

config HINFC610_DBG_NAND_DUMP
	bool "Debug: display read/write/erase process nand data"
	depends on HINFC610_DBG_NAND_DEBUG
	default y
	help
	  Create "dump" file dump to display all nand operation and data.

config HINFC610_DBG_NAND_ERASE_COUNT
	bool "Debug: display last erase count"
	depends on HINFC610_DBG_NAND_DEBUG
	default y
	help
	  Create "erase_count" file to display last erase count.

config HINFC610_DBG_NAND_READ_COUNT
	bool "Debug: display last read count"
	depends on HINFC610_DBG_NAND_DEBUG
	default y
	help
	  Create "read_count" file to display last read count.

config HINFC610_DBG_NAND_ECC_COUNT
	bool "Debug: display last ecc count."
	depends on HINFC610_DBG_NAND_DEBUG
	default y
	help
	  Create "ecc_count" to display last ecc count.

config HINFC610_DBG_NAND_READ_RETRY
	bool "Debug: display read_retry process"
	depends on HINFC610_DBG_NAND_DEBUG
	default y
	help
	  Create read_retry file to display read_retry process.
 
config CONFIG_HINFC610_DBG_NAND_CACHE
	bool "Debug: display cache information"
	depends on HINFC610_DBG_NAND_DEBUG && HINFC610_CACHE_ENABLE
	default y
	help
	  Create data file to display cache information.

choice
	prompt "Pagesize and Ecc Type Select"

config HINFC610_AUTO_PAGESIZE_ECC
	bool "Auto"
	help
	  pagesize and ecc type use hardware config

config HINFC610_PAGESIZE_AUTO_ECC_NONE
	bool "Pagesize Auto, Ecc None"
	help
	  select pagesize 2K, ecc none.

endchoice

endif # MTD_NAND_HINFC610
```

## HiSTBLinuxV100R005C00SPC041B020/source/kernel/linux-3.18.y/drivers/net/ethernet/hieth/Kconfig
```kconfig
#
# hieth family network device configuration
#

menuconfig HIETH_SWITCH_FABRIC
	tristate "hieth(switch fabric) family network device support"
	depends on (ARCH_GODBOX|| ARCH_S40 || ARCH_HI3798MX || ARCH_HI3798MV2X || ARCH_HI3796MV2X)
	select PHYLIB
	help
	  This selects the hieth family network device.

if HIETH_SWITCH_FABRIC

config HIETH_MAX_RX_POOLS
	int "hieth max rx pool size"
	default "1024"
	help
	  hieth max static rx pool size.

endif # HIETH_SWITCH_FABRIC

#vim: set ts=8 sw=8 tw=78:
```

## HiSTBLinuxV100R005C00SPC041B020/source/kernel/linux-3.18.y/drivers/net/ethernet/higmac/Kconfig
```kconfig
#
# higmac family network device configuration
#

menuconfig HIETH_GMAC
	tristate "hieth gmac family network device support"
	depends on (ARCH_S40 || ARCH_HIFONE || ARCH_HI3798CV2X || ARCH_HI3798MV2X || ARCH_HI3796MV2X)
	select PHYLIB
	select RESET_CONTROLLER
	help
	  This selects the hieth gmac family network device.
	  The gigabit switch fabric (GSF) receives and transmits data over Ethernet
	  ports at 10/100/1000 Mbit/s in full-duplex or half-duplex mode.
	  The Ethernet port exchanges data with the CPU port, and supports
	  the energy efficient Ethernet (EEE) and wake on LAN (WoL) functions.

if HIETH_GMAC

config HIGMAC_DESC_4WORD
	bool "higmac descriptor size is 4 words"
	default n
	help
	  This define the size of higmac descriptor structure.
	  In the newest version, descriptor size is 4 words.
	  But in some old version, the size is 8 words.
	  The default value is false.

config HIGMAC_RXCSUM
	bool "higmac Receive checksumming offload supported"
	default n
	help
	  This indicate MAC support Receive checksumming offload.
	  Support IPv4 and IPv6, tcp and udp.
	  The default value is disabled.
	  If old version MAC does not support, disable this option please.
endif # HIETH_GMAC
```

## HiSTBLinuxV100R005C00SPC041B020/source/msp/drv/omxvdec/Kconfig
```kconfig
config HISI_VDEC
	tristate "hisilicon video decoder support"
	depends on VFMW_V3 || VFMW_V2
	---help---
	  This driver provides kernel-side support video decoder driver.
	  If unsure, say Y.

config HISI_VDEC_DEBUG
	bool "debug verbose for hisi vdec"
	depends on HISI_VDEC
	---help---
	This is for vdec driver debug.
	If unsure, say Y.
```
